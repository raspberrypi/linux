## Documentation/devicetree/bindings/firmware/raspberrypi,vc-mem.yaml
```yaml
# SPDX-License-Identifier: (GPL-2.0 OR BSD-2-Clause)
# Copyright 2020 Hristo Venev
%YAML 1.2
---
$id: "http://devicetree.org/schemas/firmware/raspberrypi,vc-mem.yaml#"
$schema: "http://devicetree.org/meta-schemas/core.yaml#"

title: VideoCore Memory Access

maintainers:
  - Hristo Venev <hristo@venev.name>

description: |
  The firmware for the Broadcom VideoCore found in the Raspberry Pi can
  provide its exact load address to the operating system for debugging
  purposes.

  The register space used by the vc-mem node is the address space of the
  VideoCore. It is equivalent to the address space of the legacy DMA
  engines, but different from the DMA4 engines found on the Raspberry Pi 4.
  It is also different from the address space of the CPU. On some Raspberry
  Pi models, some addresses cannot be accessed by the ARM core because I/O
  memory is mapped there instead. For those ranges, DMA is the only way to
  access them.

required:
  - compatible
  - reg

properties:
  compatible:
    items:
      - const: raspberrypi,vc-mem
  reg:
    minItems: 3
    maxItems: 3
  dmas:
    minItems: 1
    maxItems: 1
  dma-names:
    items:
      - const: rx-tx

examples:
  - |
    vc_mem {
            compatible = "raspberrypi,vc-mem";
            reg = <0x3ec00000, 0x40000000, 0xc0000000>;
            dmas = <&dma 0x01>;
            dma-names = "rx-tx";
            status = "okay";
    };
```

## Documentation/devicetree/bindings/hwmon/microchip,emc2305.yaml
```yaml
# SPDX-License-Identifier: (GPL-2.0 OR BSD-2-Clause)
%YAML 1.2
---

$id: http://devicetree.org/schemas/hwmon/emc2305.yaml#
$schema: http://devicetree.org/meta-schemas/core.yaml#

title: Microchip EMC230[1|2|3|5] RPM-based PWM Fan Speed Controller

properties:
  compatible:
    enum:
      - microchip,emc2305
      - microchip,emc2301
  emc2305,pwm-min:
    description:
      Min pwm of emc2305
    maxItems: 1
  emc2305,pwm-max:
    description:
      Max pwm of emc2305
    maxItems: 1
  emc2305,pwm-channel:
    description:
      Max number of pwm channels
    maxItems: 1
  emcs205,max-state:
    description:
    maxItems: 1
  emc2305,cooling-levels:
    description:
      Quantity of cooling level state.
    maxItems: 1

required:
  - compatible

optional:
  - emc2305,min-pwm
  - emc2305,max-pwm
  - emc2305,pwm-channels
  - emc2305,cooling-levels

additionalProperties: false

examples:
  - |
    fan {
        compatible = "microchip,emc2305";
        emc2305,pwm-min = <0>;
        emc2305,pwm-max = <255>;
        emc2305,pwm-channel = <5>
        emc2305,cooling-levels = <10>;
    };
```

## Documentation/devicetree/bindings/hwmon/rpi-poe-fan.txt
```
Bindings for the Raspberry Pi PoE HAT fan

Required properties:
- compatible	: "raspberrypi,rpi-poe-fan"
- firmware	: Reference to the RPi firmware device node
- pwms		: the PWM that is used to control the PWM fan
- cooling-levels      : PWM duty cycle values in a range from 0 to 255
			which correspond to thermal cooling states

Example:
	fan0: rpi-poe-fan@0 {
		compatible = "raspberrypi,rpi-poe-fan";
		firmware = <&firmware>;
		cooling-min-state = <0>;
		cooling-max-state = <3>;
		#cooling-cells = <2>;
		cooling-levels = <0 50 150 255>;
		status = "okay";
	};

	thermal-zones {
		cpu_thermal: cpu-thermal {
			trips {
				threshold: trip-point@0 {
					temperature = <45000>;
					hysteresis = <5000>;
					type = "active";
				};
				target: trip-point@1 {
					temperature = <50000>;
					hysteresis = <2000>;
					type = "active";
				};
				cpu_hot: cpu_hot@0 {
					temperature = <55000>;
					hysteresis = <2000>;
					type = "active";
				};
			};
			cooling-maps {
				map0 {
					trip = <&threshold>;
					cooling-device = <&fan0 0 1>;
				};
				map1 {
					trip = <&target>;
					cooling-device = <&fan0 1 2>;
				};
				map2 {
					trip = <&cpu_hot>;
					cooling-device = <&fan0 2 3>;
				};
			};
		};
	};
```

## Documentation/devicetree/bindings/input/raspberrypi,firmware-button.yaml
```yaml
# SPDX-License-Identifier: (GPL-2.0-only OR BSD-2-Clause)
%YAML 1.2
---
$id: http://devicetree.org/schemas/input/raspberrypi,firmware-button.yaml#
$schema: http://devicetree.org/meta-schemas/core.yaml#

title: Raspberry Pi firmware buttons

maintainers:
  - Phil Elwell <phil@raspberrypi.com>

description: >
  The Raspberry Pi 5 firmware exposes the state of the power button. The
  raspberrypi-button driver generates a keycode when it is pressed.

properties:
  compatible:
    enum:
      - raspberrypi,firmware-button

  id:
    description: A numeric identifier of the button

  label:
    description: Descriptive name of the button.

  linux,code:
    description: Key code to emit.

required:
  - compatible
  - linux,code

additionalProperties: false

examples:
  - |
    #include <dt-bindings/input/raspberrypi-button.h>

    pwr_button: pwr_button {
        compatible = "raspberrypi,firmware-button";
        id = <RASPBERRYPI_BUTTON_POWER>;
        label = "pwr_button";
        linux,code = <116>; // KEY_POWER
    };

...
```

## Documentation/devicetree/bindings/input/touchscreen/ilitek251x.txt
```
* Ilitek 251x Multiple Touch Controller

Required properties:
- compatible: must be "ilitek,ili251x"
- reg: i2c slave address
- interrupts: touch controller interrupt
- touchscreen-size-x: See touchscreen.txt
- touchscreen-size-y: See touchscreen.txt

Example:

	touchscreen@41 {
		compatible = "ilitek,ili251x";
		reg = <0x41>;
		interrupt-parent = <&gpio1>;
		interrupts = <4 IRQ_TYPE_LEVEL_LOW>;
		touchscreen-size-x = <16384>;
		touchscreen-size-y = <9600>;
	};
```

## Documentation/devicetree/bindings/input/touchscreen/ti,tsc2007.yaml
```yaml
# SPDX-License-Identifier: (GPL-2.0-only OR BSD-2-Clause)
%YAML 1.2
---
$id: http://devicetree.org/schemas/input/touchscreen/ti,tsc2007.yaml#
$schema: http://devicetree.org/meta-schemas/core.yaml#

title: Texas Instruments TSC2007 touchscreen controller bindings

maintainers:
  - Timon Skerutsch <kernel@diodes-delight.com>

allOf:
  - $ref: touchscreen.yaml#

properties:
  compatible:
    enum:
      - ti,tsc2007

  reg:
    maxItems: 1
    description: |
      I2C address of the chip.

  interrupts:
    maxItems: 1
    description: |
      (gpio) interrupt to which the chip is connected

  gpios:
    maxItems: 1
    description: the interrupt gpio the chip is connected to (trough the penirq pin).

  ti,poll-period: how much time to wait (in milliseconds) before reading again

  touchscreen-fuzz-pressure: true
  touchscreen-fuzz-x: true
  touchscreen-fuzz-y: true
  touchscreen-min-pressure: true
  touchscreen-max-pressure: true
  touchscreen-min-x: true
  touchscreen-size-x: true
  touchscreen-min-y: true
  touchscreen-size-y: true
  touchscreen-x-plate-ohms: true
  touchscreen-inverted-x: true
  touchscreen-inverted-y: true
  touchscreen-swapped-x-y: true


additionalProperties: false

required:
  - compatible
  - reg
  - touchscreen-x-plate-ohms

examples:
  - |
    tsc2007@48 {
        compatible = "ti,tsc2007";
        reg = <0x48>;
        touchscreen-swapped-x-y;
        touchscreen-inverted-x;
        touchscreen-min-x = <350>;
        touchscreen-size-x = <3700>;
        touchscreen-fuzz-x = <4>;
        touchscreen-min-y = <320>;
        touchscreen-size-y = <3700>;
        touchscreen-fuzz-y = <4>;
        touchscreen-min-pressure = <1000>;
        touchscreen-max-pressure = <3700>;
        touchscreen-fuzz-pressure = <4>;
        touchscreen-x-plate-ohms = <180>;

        pinctrl-0 = <&tsc_int_pin>;
        interrupt-parent = <&gpio>;
        interrupts = <17 2>;
        gpios = <&gpio 17 1>;

    };
```

## Documentation/devicetree/bindings/mailbox/nvidia,tegra124-xusb-mbox.txt
```
NVIDIA Tegra XUSB mailbox
=========================

The Tegra XUSB mailbox is used by the Tegra xHCI controller's firmware to
communicate requests to the host and PHY drivers.

Refer to ./mailbox.txt for generic information about mailbox device-tree
bindings.

Required properties:
--------------------
 - compatible: For Tegra124, must contain "nvidia,tegra124-xusb-mbox".
   Otherwise, must contain '"nvidia,<chip>-xusb-mbox",
   "nvidia,tegra124-xusb-mbox"' where <chip> is tegra132.
 - #mbox-cells: Should be 0.  There is only one physical channel.

Example:
--------
	mailbox {
		compatible = "nvidia,tegra124-xusb-mbox";

		#mbox-cells = <0>;
	};

	usb-host {
		...
		mboxes = <&xusb_mbox>;
		mbox-names = "xusb";
		...
	};
```

## Documentation/devicetree/bindings/media/i2c/ad5398.txt
```
* Analog Devices AD5398 autofocus coil

Required Properties:

  - compatible: Must contain one of:
		- "adi,ad5398"

  - reg: I2C slave address

  - VANA-supply: supply of voltage for VANA pin

Example:

       ad5398: coil@c {
               compatible = "adi,ad5398";
               reg = <0x0c>;

               VANA-supply = <&vaux4>;
       };
```

## Documentation/devicetree/bindings/media/i2c/arducam-pivariety.yaml
```yaml
# SPDX-License-Identifier: (GPL-2.0-only OR BSD-2-Clause)
%YAML 1.2
---
$id: http://devicetree.org/schemas/media/i2c/arducam-pivariety.yaml#
$schema: http://devicetree.org/meta-schemas/core.yaml#

title: Arducam Pivariety Series CMOS Digital Image Sensor

maintainers:
  - Lee Jackson <info@arducam.com>

description: |-
  Arducam Pivariety series cameras make compatibility layers for various CMOS
  sensors and provide a unified command interface. It is programmable through
  I2C interface. The I2C address is fixed to 0x0C. Image data is sent through
  MIPI CSI-2, which is configured as either 1, 2 or 4 data lanes.

properties:
  compatible:
    const: arducam,arducam-pivariety

  reg:
    description: I2C device address
    maxItems: 1

  clocks:
    maxItems: 1

  VDIG-supply:
    description:
      Digital I/O voltage supply, 1.05 volts

  VANA-supply:
    description:
      Analog voltage supply, 2.8 volts

  VDDL-supply:
    description:
      Digital core voltage supply, 1.8 volts

  reset-gpios:
    description: |-
      Reference to the GPIO connected to the xclr pin, if any.
      Must be released (set high) after all supplies and INCK are applied.

  # See ../video-interfaces.txt for more details
  port:
    type: object
    properties:
      endpoint:
        type: object
        properties:
          data-lanes:
            description: |-
              The sensor supports either two-lane, or four-lane operation.
              For two-lane operation the property must be set to <1 2>.
            items:
              - const: 1
              - const: 2

          clock-noncontinuous:
            type: boolean
            description: |-
              MIPI CSI-2 clock is non-continuous if this property is present,
              otherwise it's continuous.

          link-frequencies:
            allOf:
              - $ref: /schemas/types.yaml#/definitions/uint64-array
            description:
              Allowed data bus frequencies.

        required:
          - link-frequencies

required:
  - compatible
  - reg
  - clocks
  - VANA-supply
  - VDIG-supply
  - VDDL-supply
  - port

additionalProperties: false

examples:
  - |
    i2c0 {
        #address-cells = <1>;
        #size-cells = <0>;

        arducam_pivariety: sensor@0c {
            compatible = "arducam,arducam-pivariety";
            reg = <0x0c>;
            clocks = <&arducam_pivariety_clk>;
            VANA-supply = <&arducam_pivariety_vana>;   /* 2.8v */
            VDIG-supply = <&arducam_pivariety_vdig>;   /* 1.05v */
            VDDL-supply = <&arducam_pivariety_vddl>;   /* 1.8v */

            port {
                arducam_pivariety_0: endpoint {
                    remote-endpoint = <&csi1_ep>;
                    data-lanes = <1 2>;
                    clock-noncontinuous;
                    link-frequencies = /bits/ 64 <493500000>;
                };
            };
        };
    };

...
```

## Documentation/devicetree/bindings/media/i2c/dongwoon,dw9807-vcm.yaml
```yaml
# SPDX-License-Identifier: (GPL-2.0-only OR BSD-2-Clause)
# Copyright (C) 2018, 2021 Intel Corporation
%YAML 1.2
---
$id: http://devicetree.org/schemas/media/i2c/dongwoon,dw9807-vcm.yaml#
$schema: http://devicetree.org/meta-schemas/core.yaml#

title: Dongwoon Anatech DW9807 and DW9817 voice coil lens driver

maintainers:
  - Sakari Ailus <sakari.ailus@linux.intel.com>

description: |
  DW9807 is a 10-bit DAC with current sink capability. It is intended for
  controlling voice coil lenses. The output drive is 0-100mA.
  DW9817 is very similar as a 10-bit DAC with current sink capability,
  however the output drive is a bidirection -100 to +100mA.


properties:
  compatible:
    items:
      - enum:
          - dongwoon,dw9807-vcm
          - dongwoon,dw9817-vcm

  reg:
    maxItems: 1

  VDD-supply:
    description:
      Definition of the regulator used as VDD power supply to the driver.

required:
  - compatible
  - reg

additionalProperties: false

examples:
  - |
    i2c {
        #address-cells = <1>;
        #size-cells = <0>;

        lens@e {
            compatible = "dongwoon,dw9807-vcm";
            reg = <0x0e>;
        };
    };
...
```

## Documentation/devicetree/bindings/media/i2c/rohm,bu64754.yaml
```yaml
# SPDX-License-Identifier: (GPL-2.0-only OR BSD-2-Clause)
# Copyright (C) 2023 Ideas on Board Oy.
%YAML 1.2
---
$id: http://devicetree.org/schemas/media/i2c/rohm,bu64754.yaml#
$schema: http://devicetree.org/meta-schemas/core.yaml#

title: ROHM BU64754 Actuator Driver for Camera Autofocus

maintainers:
  - Kieran Bingham <kieran.bingham@ideasonboard.com>

description: |
  The BU64754GWZ is an actuator driver IC which can control the actuator
  position precisely using an internal Hall Sensor.

properties:
  compatible:
    items:
      - enum:
          - rohm,bu64754

  reg:
    maxItems: 1

  vdd-supply:
    description:
      Definition of the regulator used as VDD power supply to the driver.

required:
  - compatible
  - reg

additionalProperties: false

examples:
  - |
    i2c {
        #address-cells = <1>;
        #size-cells = <0>;

        lens@76 {
            compatible = "rohm,bu64754";
            reg = <0x76>;
            vdd-supply = <&cam1_reg>;
        };
    };
...
```
