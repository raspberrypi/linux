## Documentation/devicetree/bindings/media/i2c/sony,imx500.yaml
```yaml
# SPDX-License-Identifier: (GPL-2.0-only OR BSD-2-Clause)
%YAML 1.2
---
$id: http://devicetree.org/schemas/media/i2c/sony,imx500.yaml#
$schema: http://devicetree.org/meta-schemas/core.yaml#

title: Sony CMOS Digital Image Sensor and CNN

maintainers:
  - Raspberry Pi <kernel-list@raspberrypi.com>

description: |-
  The Sony IMX500 is a stacked 1/2.3-inch CMOS digital image sensor and inbuilt
  AI processor with an active array CNN (Convolutional Neural Network) inference
  engine.  The native sensor size is 4056H x 3040V, and the module also contains
  an in-built ISP for the CNN. The module is programmable through an I2C
  interface with firmware and neural network uploads being made over SPI. The
  default I2C address is 0x1A, with an address of 0x10 being selectable via
  SLASEL. The module also has a second I2C interface available with a fixed
  address of 0x36.  Image data is sent through MIPI CSI-2, which is configured
  as either 2 or 4 data lanes.

properties:
  compatible:
    const: sony,imx500

  reg:
    description: I2C device address
    maxItems: 1

  clocks:
    maxItems: 1

  clock-names:
    description: |-
      Input clock (12 to 27 MHz)
    items:
      - const: inck

  interrupts:
    maxItems: 1

  vana-supply:
    description: Supply voltage (analog) - 2.7 V

  vdig-supply:
    description: Supply voltage (digital) - 0.84 V

  vif-supply:
    description: Supply voltage (interface) - 1.8 V

  reset-gpios:
    description: |-
      Sensor reset (XCLR) GPIO

      Chip clear in lieu of built-in power on reset. To be set 'High' after
      power supplies are brought up and INCK supplied.

  port:
    $ref: /schemas/graph.yaml#/$defs/port-base
    additionalProperties: false
    description: |
      Video output port

    properties:
      endpoint:
        $ref: /schemas/media/video-interfaces.yaml#
        type: object
        unevaluatedProperties: false
        properties:
          data-lanes:
            items:
              - const: 1
              - const: 2
          clock-noncontinuous: true
          link-frequencies: true
          clock-lanes:
            items:
              - const: 0
        required:
          - link-frequencies
          - clock-lanes
          - data-lanes

required:
  - compatible
  - reg

allOf:
  - $ref: /schemas/spi/spi-peripheral-props.yaml#
  - if:
      required:
        - spi-max-frequency
    then:
      properties:
        # SPI node
        clocks: false
        clock-names: false
        vana-supply: false
        vdig-supply: false
        vif-supply: false
        reset-gpios: false
        port: false
    else:
      required:
        - clocks
        - clock-names
        - vana-supply
        - vdig-supply
        - vif-supply
        - reset-gpios
        - port

unevaluatedProperties: false

examples:
  - |
    #include <dt-bindings/gpio/gpio.h>

    i2c {
      #address-cells = <1>;
      #size-cells = <0>;

      imx500: sensor@1a {
        compatible = "sony,imx500";
        reg = <0x1a>;

        clocks = <&imx500_clk>;
        clock-names = "inck";

        vana-supply = <&imx500_vana>; /* 2.7  +/- 0.1  V */
        vdig-supply = <&imx500_vdig>; /* 0.84 +/- 0.04 V */
        vif-supply  = <&imx500_vif>;  /* 1.8  +/- 0.1  V */

        reset-gpios = <&gpio_sensor 0 GPIO_ACTIVE_LOW>;

        port {
          imx500_0: endpoint {
            clock-lanes = <0>;
            remote-endpoint = <&csi1_ep>;
            data-lanes = <1 2>;
            clock-noncontinuous;
            link-frequencies = /bits/ 64 <499500000>;
          };
        };
      };
    };

    spi {
      #address-cells = <1>;
      #size-cells = <0>;

      sensor@0 {
        compatible = "sony,imx500";
        reg = <0>;
        spi-max-frequency = <35000000>;
      };
    };

...
```

## Documentation/devicetree/bindings/media/i2c/sony,imx708.yaml
```yaml
# SPDX-License-Identifier: (GPL-2.0 OR BSD-2-Clause)
%YAML 1.2
---
$id: http://devicetree.org/schemas/media/i2c/sony,imx708.yaml#
$schema: http://devicetree.org/meta-schemas/core.yaml#

title: Sony 1/2.3-Inch 12Mpixel CMOS Digital Image Sensor

maintainers:
  - Raspberry Pi Kernel Maintenance <kernel-list@raspberrypi.com>

description: |-
  The Sony IMX708 is a 1/2.3-inch CMOS active pixel digital image sensor
  with an active array size of 4608H x 2592V. It is programmable through
  I2C interface. The I2C address is fixed to 0x1A as per sensor data sheet.
  Image data is sent through MIPI CSI-2, which is configured as either 2 or
  4 data lanes.

properties:
  compatible:
    const: sony,imx708

  reg:
    maxItems: 1

  clocks:
    maxItems: 1

  clock-names:
    description: Input clock (6 to 27 MHz)
    items:
      - const: inck

  vdig-supply:
    description:
      Digital I/O voltage supply, 1.1 volts

  vana1-supply:
    description:
      Analog1 voltage supply, 2.8 volts

  vana2-supply:
    description:
      Analog2 voltage supply, 1.8 volts

  vddl-supply:
    description:
      Digital core voltage supply, 1.8 volts

  reset-gpios:
    description: Sensor reset (XCLR) GPIO
    maxItems: 1

  port:
    $ref: /schemas/graph.yaml#/$defs/port-base
    description: |
      Video output port

    properties:
      endpoint:
        $ref: /schemas/media/video-interfaces.yaml#
        unevaluatedProperties: false

        properties:
          data-lanes:
            anyOf:
              - items:
                  - const: 1
                  - const: 2
              - items:
                  - const: 1
                  - const: 2
                  - const: 3
                  - const: 4

          link-frequencies: true

        required:
          - data-lanes
          - link-frequencies

    additionalProperties: false

required:
  - compatible
  - reg
  - clocks
  - clock-names
  - vdig-supply
  - vana1-supply
  - vana2-supply
  - vddl-supply
  - port

additionalProperties: false

examples:
  - |
    #include <dt-bindings/gpio/gpio.h>

    i2c {
        #address-cells = <1>;
        #size-cells = <0>;

        imx708: camera-sensor@1a {
            compatible = "sony,imx708";
            reg = <0x1a>;

            clocks = <&clk 90>;
            clock-names = "inck";

            vdig-supply = <&camera_vdig>;
            vana1-supply = <&camera_vana1>;
            vana2-supply = <&camera_vana2>;
            vddl-supply = <&camera_vddl>;

            reset-gpios = <&gpio 35 GPIO_ACTIVE_LOW>;

            port {
                imx708_ep: endpoint {
                    data-lanes = <1 2>;
                    link-frequencies = /bits/ 64 <450000000>;
                    remote-endpoint = <&csi_ep>;
                };
            };
        };
    };
...
```

## Documentation/devicetree/bindings/media/raspberrypi,hevc-dec.yaml
```yaml
# SPDX-License-Identifier: (GPL-2.0-only OR BSD-2-Clause)
%YAML 1.2
---
$id: http://devicetree.org/schemas/media/raspberrypi,hevc-dec.yaml#
$schema: http://devicetree.org/meta-schemas/core.yaml#

title: Raspberry Pi HEVC Decoder

maintainers:
  - John Cox <john.cox@raspberrypi.com>
  - Dom Cobley <dom@raspberrypi.com>
  - Dave Stevenson <dave.stevenson@raspberrypi.com>
  - Raspberry Pi internal review list <kernel-list@raspberrypi.com>

description:
  The Raspberry Pi HEVC decoder is a hardware video decode accelerator block
  found in the BCM2711 and BCM2712 processors used on Raspberry Pi 4 and 5
  boards respectively.

properties:
  compatible:
    items:
      - enum:
          - brcm,bcm2711-hevc-dec
          - brcm,bcm2712-hevc-dec
      - const: raspberrypi,hevc-dec

  reg:
    items:
      - description: The HEVC main register region
      - description: The Interrupt control register region

  reg-names:
    items:
      - const: hevc
      - const: intc

  interrupts:
    maxItems: 1

  clocks:
    items:
      - description: The HEVC block clock

required:
  - compatible
  - reg
  - reg-names
  - interrupts
  - clocks

additionalProperties: false

examples:
  - |
    #include <dt-bindings/interrupt-controller/arm-gic.h>

    video-codec@7eb10000 {
        compatible = "brcm,bcm2711-hevc-dec", "raspberrypi,hevc-dec";
        reg = <0x7eb00000 0x10000>, /* HEVC */
              <0x7eb10000 0x1000>;  /* INTC */
        reg-names = "hevc",
                    "intc";

        interrupts = <GIC_SPI 98 IRQ_TYPE_LEVEL_HIGH>;

        clocks = <&clk 0>;
    };

...
```

## Documentation/devicetree/bindings/media/raspberrypi,pispbe.yaml
```yaml
# SPDX-License-Identifier: (GPL-2.0+ OR MIT)
%YAML 1.2
---
$id: http://devicetree.org/schemas/media/raspberrypi,pispbe.yaml#
$schema: http://devicetree.org/meta-schemas/core.yaml#

title: Raspberry Pi PiSP Image Signal Processor (ISP) Back End

maintainers:
  - Dave Stevenson <dave.stevenson@raspberrypi.com>
  - David Plowman <david.plowman@raspberrypi.com>
  - Jacopo Mondi <jacopo.mondi@ideasonboard.com>
  - Naushir Patuck <naush@raspberrypi.com>
  - Nick Hollinghurst <nick.hollinghurst@raspberrypi.com>

description: |
  The Raspberry Pi PiSP Image Signal Processor (ISP) Back End is an image
  processor that fetches images in Bayer or Grayscale format from DRAM memory
  in tiles and produces images consumable by application.

  The full ISP documentation is available at:
  https://datasheets.raspberrypi.com/camera/raspberry-pi-image-signal-processor-specification.pdf

properties:
  compatible:
    const: raspberrypi,pispbe

  reg:
    maxItems: 1

  interrupts:
    maxItems: 1

  clocks:
    maxItems: 1

  clock-names:
    const: isp_be

  iommus:
    maxItems: 1

required:
  - compatible
  - reg
  - interrupts
  - clocks
  - clock-names

additionalProperties: false

examples:
  - |
    #include <dt-bindings/interrupt-controller/arm-gic.h>

    rpi1 {
        #address-cells = <2>;
        #size-cells = <2>;

        isp: pisp_be@880000  {
             compatible = "raspberrypi,pispbe";
             reg = <0x10 0x00880000  0x0 0x4000>;
             interrupts = <GIC_SPI 72 IRQ_TYPE_LEVEL_HIGH>;
             clocks = <&firmware_clocks 7>;
             clock-names = "isp_be";
             iommus = <&iommu2>;
        };
    };
```

## Documentation/devicetree/bindings/media/rpivid_hevc.yaml
```yaml
# SPDX-License-Identifier: GPL-2.0-only
%YAML 1.2
---
$id: http://devicetree.org/schemas/media/rpivid_hevc.yaml#
$schema: http://devicetree.org/meta-schemas/core.yaml#

title: Raspberry Pi HEVC Decoder

maintainers:
  - Raspberry Pi <kernel-list@raspberrypi.com>

description: |-
  The Camera Adaptation Layer (CAL) is a key component for image capture
  applications. The capture module provides the system interface and the
  processing capability to connect CSI2 image-sensor modules to the
  DRA72x device.

properties:
  compatible:
    enum:
      - raspberrypi,rpivid-vid-decoder

  reg:
    minItems: 2
    items:
      - description: The HEVC main register region
      - description: The Interrupt controller register region

  reg-names:
    minItems: 2
    items:
      - const: hevc
      - const: intc

  interrupts:
    maxItems: 1

  clocks:
    items:
      - description: The HEVC block clock

  clock-names:
    items:
      - const: hevc

required:
  - compatible
  - reg
  - reg-names
  - interrupts
  - clocks

additionalProperties: false

examples:
  - |
    #include <dt-bindings/interrupt-controller/arm-gic.h>

    video-codec@7eb10000 {
        compatible = "raspberrypi,rpivid-vid-decoder";
        reg = <0x0 0x7eb10000 0x1000>,	/* INTC */
              <0x0 0x7eb00000 0x10000>; /* HEVC */
        reg-names = "intc",
                    "hevc";

        interrupts = <GIC_SPI 98 IRQ_TYPE_LEVEL_HIGH>;

        clocks = <&clk 0>;
        clock-names = "hevc";
    };

...
```
