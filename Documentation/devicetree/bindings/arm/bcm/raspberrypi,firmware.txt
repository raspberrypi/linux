## Documentation/devicetree/bindings/arm/bcm/raspberrypi,firmware.txt
```
Raspberry Pi VideoCore firmware driver

Required properties:

- compatible:		Should be "rasbperrypi,firmware"
- mboxes:		Phandle to the firmware device's Mailbox.
			  (See: ../mailbox/mailbox.txt for more information)

Example:

firmware {
	compatible = "raspberrypi,firmware";
	mboxes = <&mailbox>;
};
```

## Documentation/devicetree/bindings/clock/gpio-gate-clock.yaml
```yaml
# SPDX-License-Identifier: (GPL-2.0-only OR BSD-2-Clause)
%YAML 1.2
---
$id: http://devicetree.org/schemas/clock/gpio-gate-clock.yaml#
$schema: http://devicetree.org/meta-schemas/core.yaml#

title: Simple GPIO clock gate

maintainers:
  - Jyri Sarha <jsarha@ti.com>

properties:
  compatible:
    enum:
      - gpio-gate-clock
      - gpio-gate-clock-releasing
    description: |
      Use "gpio-gate-clock" for normal operation where the GPIO is held for the
      lifetime of the clock. Use "gpio-gate-clock-releasing" for power-sensitive
      applications where the GPIO should be acquired only when the clock is
      enabled and released when disabled, allowing shared regulators to be
      powered down.

  clocks:
    maxItems: 1

  '#clock-cells':
    const: 0

  enable-gpios:
    description: GPIO reference for enabling and disabling the clock.
    maxItems: 1

required:
  - compatible
  - '#clock-cells'
  - enable-gpios

additionalProperties: false

examples:
  - |
    #include <dt-bindings/gpio/gpio.h>

    clock {
        compatible = "gpio-gate-clock";
        clocks = <&parentclk>;
        #clock-cells = <0>;
        enable-gpios = <&gpio 1 GPIO_ACTIVE_HIGH>;
    };

  - |
    #include <dt-bindings/gpio/gpio.h>

    /* Power-sensitive clock that releases GPIO when disabled */
    clock {
        compatible = "gpio-gate-clock-releasing";
        clocks = <&parentclk>;
        #clock-cells = <0>;
        enable-gpios = <&gpio 1 GPIO_ACTIVE_HIGH>;
    };
```

## Documentation/devicetree/bindings/clock/raspberrypi,firmware-clocks.yaml
```yaml
# SPDX-License-Identifier: (GPL-2.0-only OR BSD-2-Clause)
%YAML 1.2
---
$id: http://devicetree.org/schemas/clock/raspberrypi,firmware-clocks.yaml#
$schema: http://devicetree.org/meta-schemas/core.yaml#

title: RaspberryPi Firmware Clocks Device Tree Bindings

maintainers:
  - Maxime Ripard <mripard@kernel.org>

properties:
  "#clock-cells":
    const: 1

  compatible:
    const: raspberrypi,firmware-clocks

required:
  - "#clock-cells"
  - compatible

additionalProperties: false

examples:
  - |
    firmware_clocks: firmware-clocks {
        compatible = "raspberrypi,firmware-clocks";
        #clock-cells = <1>;
    };

...
```

## Documentation/devicetree/bindings/cpufreq/virtual,android-v-only-cpufreq.yaml
```yaml
# SPDX-License-Identifier: GPL-2.0-only OR BSD-2-Clause
%YAML 1.2
---
$id: http://devicetree.org/schemas/cpufreq/virtual,android-v-only-cpufreq.yaml#
$schema: http://devicetree.org/meta-schemas/core.yaml#

title: Android-V-Only Virtual CPUFreq

maintainers:
  - David Dai <davidai@google.com>
  - Saravana Kannan <saravanak@google.com>

description:
  Android-V-Only Virtual CPUFreq is a virtualized driver in guest kernels that
  sends frequency selection of its vCPUs as a hint to the host through MMIO
  regions.  Each vCPU is associated with a frequency domain which can be shared
  with other vCPUs.  Each frequency domain has its own set of registers for
  frequency controls.

properties:
  compatible:
    const: virtual,android-v-only-cpufreq

  reg:
    maxItems: 1
    description:
      Address and size of region containing frequency controls for each of the
      frequency domains. Regions for each frequency domain is placed
      contiguously and contain registers for controlling DVFS(Dynamic Frequency
      and Voltage) characteristics. The size of the region is proportional to
      total number of frequency domains. This device also needs the CPUs to
      list their OPPs using operating-points-v2 tables. The OPP tables for the
      CPUs should use normalized "frequency" values where the OPP with the
      highest performance among all the vCPUs is listed as 1024 KHz. The rest
      of the frequencies of all the vCPUs should be normalized based on their
      performance relative to that 1024 KHz OPP. This makes it much easier to
      migrate the VM across systems which might have different physical CPU
      OPPs.

required:
  - compatible
  - reg

additionalProperties: false

examples:
  - |
    // This example shows a two CPU configuration with a frequency domain
    // for each CPU showing normalized performance points.
    cpus {
      #address-cells = <1>;
      #size-cells = <0>;

      cpu@0 {
        compatible = "arm,armv8";
        device_type = "cpu";
        reg = <0x0>;
        operating-points-v2 = <&opp_table0>;
      };

      cpu@1 {
        compatible = "arm,armv8";
        device_type = "cpu";
        reg = <0x0>;
        operating-points-v2 = <&opp_table1>;
      };
    };

    opp_table0: opp-table-0 {
      compatible = "operating-points-v2";

      opp64000 { opp-hz = /bits/ 64 <64000>; };
      opp128000 { opp-hz = /bits/ 64 <128000>; };
      opp192000 { opp-hz = /bits/ 64 <192000>; };
      opp256000 { opp-hz = /bits/ 64 <256000>; };
      opp320000 { opp-hz = /bits/ 64 <320000>; };
      opp384000 { opp-hz = /bits/ 64 <384000>; };
      opp425000 { opp-hz = /bits/ 64 <425000>; };
    };

    opp_table1: opp-table-1 {
      compatible = "operating-points-v2";

      opp64000 { opp-hz = /bits/ 64 <64000>; };
      opp128000 { opp-hz = /bits/ 64 <128000>; };
      opp192000 { opp-hz = /bits/ 64 <192000>; };
      opp256000 { opp-hz = /bits/ 64 <256000>; };
      opp320000 { opp-hz = /bits/ 64 <320000>; };
      opp384000 { opp-hz = /bits/ 64 <384000>; };
      opp448000 { opp-hz = /bits/ 64 <448000>; };
      opp512000 { opp-hz = /bits/ 64 <512000>; };
      opp576000 { opp-hz = /bits/ 64 <576000>; };
      opp640000 { opp-hz = /bits/ 64 <640000>; };
      opp704000 { opp-hz = /bits/ 64 <704000>; };
      opp768000 { opp-hz = /bits/ 64 <768000>; };
      opp832000 { opp-hz = /bits/ 64 <832000>; };
      opp896000 { opp-hz = /bits/ 64 <896000>; };
      opp960000 { opp-hz = /bits/ 64 <960000>; };
      opp1024000 { opp-hz = /bits/ 64 <1024000>; };

    };

    soc {
      #address-cells = <1>;
      #size-cells = <1>;

      cpufreq@1040000 {
        compatible = "virtual,android-v-only-cpufreq";
        reg = <0x1040000 0x10>;
      };
    };
```

## Documentation/devicetree/bindings/display/brcm,bcm2835-hdmi.yaml
```yaml
# SPDX-License-Identifier: GPL-2.0
%YAML 1.2
---
$id: http://devicetree.org/schemas/display/brcm,bcm2835-hdmi.yaml#
$schema: http://devicetree.org/meta-schemas/core.yaml#

title: Broadcom VC4 (VideoCore4) HDMI Controller

maintainers:
  - Eric Anholt <eric@anholt.net>

properties:
  compatible:
    enum:
      - brcm,bcm2835-hdmi
      - brcm,bcm2711-hdmi0
      - brcm,bcm2711-hdmi1

  reg:
    oneOf:
      - items:
        - description: HDMI register range
        - description: HD register range

      - items:
        - description: HDMI controller register range
        - description: DVP register range
        - description: HDMI PHY register range
        - description: Rate Manager register range
        - description: Packet RAM register range
        - description: Metadata RAM register range
        - description: CSC register range
        - description: CEC register range
        - description: HD register range

  reg-names:
    items:
      - const: hdmi
      - const: dvp
      - const: phy
      - const: rm
      - const: packet
      - const: metadata
      - const: csc
      - const: cec
      - const: hd

  interrupts:
    minItems: 2

  clocks:
    oneOf:
      - items:
        - description: The pixel clock
        - description: The HDMI state machine clock

      - items:
        - description: The HDMI state machine clock

  clock-names:
    oneOf:
      - items:
        - const: pixel
        - const: hdmi

      - const: hdmi

  ddc:
    $ref: /schemas/types.yaml#/definitions/phandle
    description: >
      Phandle of the I2C controller used for DDC EDID probing

  hpd-gpios:
    maxItems: 1
    description: >
      The GPIO pin for the HDMI hotplug detect (if it doesn't appear
      as an interrupt/status bit in the HDMI controller itself)

  dmas:
    maxItems: 1
    description: >
      Should contain one entry pointing to the DMA channel used to
      transfer audio data.

  dma-names:
    const: audio-rx

  power-domains:
    maxItems: 1

  resets:
    maxItems: 1

required:
  - compatible
  - reg
  - clocks
  - ddc

additionalProperties: false

if:
  properties:
    compatible:
      contains:
        enum:
          - brcm,bcm2711-hdmi0
          - brcm,bcm2711-hdmi1

then:
  properties:
    reg:
      minItems: 9

    clocks:
      maxItems: 1

    clock-names:
      maxItems: 1

  required:
    - reg-names
    - resets

else:
  properties:
    reg:
      maxItems: 2

    clocks:
      minItems: 2

    clock-names:
      minItems: 2

  required:
    - interrupts

examples:
  - |
    #include <dt-bindings/clock/bcm2835.h>
    #include <dt-bindings/gpio/gpio.h>

    hdmi: hdmi@7e902000 {
        compatible = "brcm,bcm2835-hdmi";
        reg = <0x7e902000 0x600>,
              <0x7e808000 0x100>;
        interrupts = <2 8>, <2 9>;
        ddc = <&i2c2>;
        hpd-gpios = <&gpio 46 GPIO_ACTIVE_HIGH>;
        clocks = <&clocks BCM2835_PLLH_PIX>,
                 <&clocks BCM2835_CLOCK_HSM>;
        clock-names = "pixel", "hdmi";
    };

  - |
    hdmi0: hdmi@7ef00700 {
        compatible = "brcm,bcm2711-hdmi0";
        reg = <0x7ef00700 0x300>,
              <0x7ef00300 0x200>,
              <0x7ef00f00 0x80>,
              <0x7ef00f80 0x80>,
              <0x7ef01b00 0x200>,
              <0x7ef01f00 0x400>,
              <0x7ef00200 0x80>,
              <0x7ef04300 0x100>,
              <0x7ef20000 0x100>;
        reg-names = "hdmi",
                    "dvp",
                    "phy",
                    "rm",
                    "packet",
                    "metadata",
                    "csc",
                    "cec",
                    "hd";
        clocks = <&firmware_clocks 13>;
        clock-names = "hdmi";
        resets = <&dvp 0>;
        ddc = <&ddc0>;
    };

...
```

## Documentation/devicetree/bindings/display/panel/waveshare,dsi-touch.yaml
```yaml
# SPDX-License-Identifier: (GPL-2.0-only OR BSD-2-Clause)
%YAML 1.2
---
$id: http://devicetree.org/schemas/display/panel/waveshare,dsi-touch.yaml#
$schema: http://devicetree.org/meta-schemas/core.yaml#

title: Waveshare DSI Touchscreen Panels

maintainers:
  - Waveshare_Team <support@waveshare.com>

description: |
  Waveshare DSI touchscreen panels with integrated touch controller.
  These panels use MIPI DSI interface and come in various sizes from
  3.4" to 12.3".

properties:
  compatible:
    items:
      - enum:
          - waveshare,3.4-dsi-touch-c
          - waveshare,4.0-dsi-touch-a
          - waveshare,4.0-dsi-touch-c
          - waveshare,4.3-dsi-touch-a
          - waveshare,5.0-dsi-touch-a
          - waveshare,5.5-dsi-touch-a
          - waveshare,7.0-dsi-touch-a
          - waveshare,7.0-dsi-touch-b
          - waveshare,7.0-dsi-touch-c
          - waveshare,8.0-dsi-touch-a
          - waveshare,8.0-dsi-touch-a-4lane
          - waveshare,8.8-dsi-touch-a
          - waveshare,9.0-dsi-touch-b
          - waveshare,9.0-dsi-touch-b,4lane
          - waveshare,10.1-dsi-touch-a
          - waveshare,10.1-dsi-touch-a-4lane
          - waveshare,10.1-dsi-touch-b
          - waveshare,10.1-dsi-touch-b,4lane
          - waveshare,12.3-dsi-touch-a,4lane

  reg:
    description: DSI virtual channel
    maxItems: 1

  port: true
  reset-gpios: true
  rotation: true
  backlight: true

required:
  - compatible
  - reg
  - port

allOf:
  - $ref: panel-common.yaml#

unevaluatedProperties: false

examples:
  - |
    dsi {
        #address-cells = <1>;
        #size-cells = <0>;

        panel@0 {
            compatible = "waveshare,4.0-dsi-touch-a";
            reg = <0>;
            reset-gpios = <&gpio 4 1 GPIO_ACTIVE_HIGH>;
            backlight = <&backlight>;

            port {
                panel_in: endpoint {
                    remote-endpoint = <&dsi_out>;
                };
            };
        };
    };
```

## Documentation/devicetree/bindings/display/tm1637.txt
```
Titan Micro Electronics TM1637 RAM mapping 8*6 LED controller driver with keyscan
-------------------------------------------------------------------------------

Required properties:
  - compatible: Must contain "tm,tm1637",
  - clk-gpios: Must contain a GPIO specifier, referring to the GPIO pin
    connected to the "CLK" (Clock) signal line of the LED Controller's bus
    interface,
  - dio-gpios: Must contain a GPIO specifier, referring to the GPIO pin
    connected to the "DIO" (Data Input/Output) signal line of the LED Controller's bus
    interface,
  - delay-ns: Delay fo GPIO port, on bus interface.

Example:

	auxdisplay {
		compatible = "tm,tm1637";

		clk-gpios = <&gpio 3 0>;
		dio-gpios = <&gpio 2 0>;
		
		delay-ns = <100>;
	};

The TM1637 driver provides simple interfaces as below.
Valied values for <n> are between 0 and 5.
led<n>     : Write LED value is used for writing LED value
key        : Read Key value is read via the key matrix.
brightness : Control LED brightness
leds       : Switch on LED

For example, switch on LED in TM1637
echo on > /sys/bus/platform/devices/auxdisplay/leds

For example, write LED values in TM1637
echo 128 > /sys/bus/platform/devices/auxdisplay/led<n>

For example, read key value in TM1637
cat /sys/bus/platform/devices/auxdisplay/key

For example, control maximum brightness in TM1637
echo 7 >/sys/bus/platform/devices/auxdisplay/brightness
```

## Documentation/devicetree/bindings/firmware/mediatek,geniezone.yaml
```yaml
# SPDX-License-Identifier: (GPL-2.0-only OR BSD-2-Clause)
%YAML 1.2
---
$id: http://devicetree.org/schemas/firmware/mediatek,geniezone.yaml#
$schema: http://devicetree.org/meta-schemas/core.yaml#

title: MediaTek GenieZone hypervisor

maintainers:
  - Yingshiuan Pan <yingshiuan.pan@mediatek.com>

description:
  GenieZone is a proprietary type-II hypervisor firmware developed by MediaTek,
  providing an isolated execution environment for mTEE (MediaTek Trusted
  Execution Environment) and AVF (Android Virtualization Framework) virtual
  machines. This binding facilitates the integration of GenieZone into the
  Android Virtualization Framework (AVF) with Crosvm as the VMM. The driver
  exposes hypervisor control interfaces to the VMM for managing virtual
  machine lifecycles and assisting virtual device emulation.

properties:
  compatible:
    const: mediatek,geniezone

required:
  - compatible

additionalProperties: false

examples:
  - |
    hypervisor {
        compatible = "mediatek,geniezone";
    };
```
