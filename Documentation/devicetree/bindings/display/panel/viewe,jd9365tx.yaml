## Documentation/devicetree/bindings/display/panel/viewe,jd9365tx.yaml
```yaml
# SPDX-License-Identifier: (GPL-2.0-only OR BSD-2-Clause)
%YAML 1.2
---
$id: http://devicetree.org/schemas/display/panel/viewe,jd9365tx.yaml#
$schema: http://devicetree.org/meta-schemas/core.yaml#

title: VIEWE 7.0" 720x1280 Jadard JD9365TX MIPI-DSI in-cell panel

maintainers:
  - Hefei <3066883572@qq.com>

description: |
  The VIEWE 7KF82 module is a 720x1280 RGB888 video-mode MIPI-DSI panel
  based on Jadard JD9365TX. It uses two DSI data lanes and exposes in-cell
  touch over I2C on the same FPC.

allOf:
  - $ref: panel-common.yaml#

properties:
  compatible:
    const: viewe,7kf82

  reg:
    maxItems: 1

  vdd-supply:
    description: Panel VDD supply, usually 3.3V

  iovcc-supply:
    description: Panel IO voltage supply, usually 3.3V

  vccio-supply:
    description: Alternate name for iovcc-supply

  reset-gpios:
    description: Optional panel reset GPIO (omit if board uses POR only).
    maxItems: 1

  backlight: true
  rotation: true
  port: true

required:
  - compatible
  - reg
  - vdd-supply

anyOf:
  - required: [iovcc-supply]
  - required: [vccio-supply]

additionalProperties: false

examples:
  - |
    dsi {
        #address-cells = <1>;
        #size-cells = <0>;

        panel@0 {
            compatible = "viewe,7kf82";
            reg = <0>;
            vdd-supply = <&reg_vdd>;
            iovcc-supply = <&reg_iovcc>;
            backlight = <&viewe_bl>;

            port {
                endpoint {
                    remote-endpoint = <&dsi_out>;
                    data-lanes = <0 1>;
                };
            };
        };
    };
...
```

## Documentation/devicetree/bindings/iio/imu/adi,adis16550.yaml
```yaml
# SPDX-License-Identifier: (GPL-2.0 OR BSD-2-Clause)
%YAML 1.2
---
$id: http://devicetree.org/schemas/iio/imu/adi,adis16550.yaml#
$schema: http://devicetree.org/meta-schemas/core.yaml#
title: Analog Devices ADIS16550 and similar IMUs
maintainers:
  - Nuno Sa <nuno.sa@analog.com>
  - Ramona Gradinariu <ramona.gradinariu@analog.com>
  - Antoniu Miclaus <antoniu.miclaus@analog.com>
properties:
  compatible:
    enum:
      - adi,adis16550
      - adi,adis16550w
  reg:
    maxItems: 1
  spi-cpha: true
  spi-cpol: true
  spi-max-frequency:
    maximum: 15000000
  vdd-supply: true
  interrupts:
    maxItems: 1
  reset-gpios:
    description:
      Must be the device tree identifier of the RESET pin. If specified,
      it will be asserted during driver probe. As the line is active low,
      it should be marked GPIO_ACTIVE_LOW.
    maxItems: 1
  clocks:
    description: If not provided, then the internal clock is used.
    maxItems: 1
  clock-frequency:
    description: Clock frequency in Hz when an external clock is used.
    oneOf:
      - type: integer
        minimum: 1
        maximum: 128
      - type: integer
        minimum: 3000
        maximum: 4500

required:
  - compatible
  - reg
  - interrupts
  - spi-cpha
  - spi-cpol
  - spi-max-frequency
  - vdd-supply

allOf:
  - if:
      properties:
        clocks:
          maxItems: 1
    then:
      required:
        - clock-frequency

  - $ref: /schemas/spi/spi-peripheral-props.yaml#
additionalProperties: false
examples:
  - |
    #include <dt-bindings/interrupt-controller/irq.h>
    spi {
        #address-cells = <1>;
        #size-cells = <0>;
        imu@0 {
            compatible = "adi,adis16550";
            reg = <0>;
            spi-max-frequency = <15000000>;
            spi-cpol;
            spi-cpha;
            vdd-supply = <&vdd>;
            interrupts = <4 IRQ_TYPE_EDGE_FALLING>;
            interrupt-parent = <&gpio>;
        };
    };
```

## Documentation/devicetree/bindings/input/touchscreen/jadard,jd9365tx.yaml
```yaml
# SPDX-License-Identifier: (GPL-2.0-only OR BSD-2-Clause)
%YAML 1.2
---
$id: http://devicetree.org/schemas/input/touchscreen/jadard,jd9365tx.yaml#
$schema: http://devicetree.org/meta-schemas/core.yaml#

title: Jadard JD9365TX in-cell touchscreen

maintainers:
  - Hefei <3066883572@qq.com>

description: |
  In-cell touch integrated with Jadard JD9365TX DSI panels. The module FPC
  often exposes only I2C (no interrupt GPIO); the driver polls coordinate
  reports.

allOf:
  - $ref: touchscreen.yaml#

properties:
  compatible:
    const: jadard,jd9365tx

  reg:
    maxItems: 1

  poll-interval: true

  jadard,coord-addr:
    description: Optional fixed coordinate SRAM address override
    $ref: /schemas/types.yaml#/definitions/uint32

required:
  - compatible
  - reg

unevaluatedProperties: false

examples:
  - |
    i2c {
        #address-cells = <1>;
        #size-cells = <0>;

        touchscreen@68 {
            compatible = "jadard,jd9365tx";
            reg = <0x68>;
            touchscreen-size-x = <720>;
            touchscreen-size-y = <1280>;
            poll-interval = <16>;
        };
    };
...
```

## Documentation/devicetree/bindings/leds/backlight/viewe,i2c-backlight.yaml
```yaml
# SPDX-License-Identifier: (GPL-2.0-only OR BSD-2-Clause)
%YAML 1.2
---
$id: http://devicetree.org/schemas/leds/backlight/viewe,i2c-backlight.yaml#
$schema: http://devicetree.org/meta-schemas/core.yaml#

title: VIEWE I2C panel backlight

maintainers:
  - Hefei <3066883572@qq.com>

description: |
  Simple I2C backlight used on VIEWE DSI modules. Default protocol is device
  address 0x45, register 0x86, brightness 0..255.

allOf:
  - $ref: common.yaml#

properties:
  compatible:
    const: viewe,i2c-backlight

  reg:
    maxItems: 1

  default-brightness:
    description: Brightness applied at probe (0..255)
    minimum: 0
    maximum: 255

required:
  - compatible
  - reg

additionalProperties: false

examples:
  - |
    i2c {
        #address-cells = <1>;
        #size-cells = <0>;

        backlight@45 {
            compatible = "viewe,i2c-backlight";
            reg = <0x45>;
            default-brightness = <200>;
        };
    };
...
```

## Documentation/devicetree/bindings/media/i2c/sony,imx662.yaml
```yaml
# SPDX-License-Identifier: (GPL-2.0-only OR BSD-2-Clause)
%YAML 1.2
---
$id: http://devicetree.org/schemas/media/i2c/sony,imx662.yaml#
$schema: http://devicetree.org/meta-schemas/core.yaml#

title: Sony IMX662 CMOS Image Sensor

maintainers:
  - Dave Stevenson <dave.stevenson@raspberrypi.com>

description:
  The Sony IMX662 is a 1/2.8-inch CMOS image sensor with a pixel
  array of 1936x1100 pixels, capable of up to 90 fps.
  It supports MIPI CSI-2 output with 2 or 4 data lanes,
  RAW10/RAW12 output, and both colour and monochrome variants.

allOf:
  - $ref: /schemas/media/video-interface-devices.yaml#

properties:
  compatible:
    enum:
      - sony,imx662aaqr  # Colour variant
      - sony,imx662aamr  # Monochrome variant

  reg:
    maxItems: 1
    description: I2C device address

  clocks:
    maxItems: 1
    description: Master clock input (xclk).

  reset-gpios:
    maxItems: 1
    description: Sensor reset (XCLR) pin, active low (optional).

  avdd-supply:
    description: Analog 3.3V power supply (optional).

  dvdd-supply:
    description: Digital core 1.1V power supply (optional).

  ovdd-supply:
    description: Digital I/O 1.8V power supply (optional).

  orientation: true
  rotation: true

  port:
    $ref: /schemas/graph.yaml#/$defs/port-base
    description: CSI-2 transmitter port
    additionalProperties: false
    properties:
      endpoint:
        $ref: /schemas/media/video-interfaces.yaml#
        unevaluatedProperties: false
        properties:
          data-lanes:
            description: Number of MIPI CSI-2 data lanes (must be 2 or 4)
            minItems: 2
            maxItems: 4
            items:
              enum: [1, 2, 3, 4]

          link-frequencies:
            description: Allowed MIPI link frequencies in Hz
            minItems: 1
            maxItems: 8
            items:
              enum: [297000000, 360000000, 445500000, 594000000,
                     720000000, 891000000, 1039500000, 1188000000]
        required:
          - data-lanes
          - link-frequencies
    required:
      - endpoint

required:
  - compatible
  - reg
  - clocks
  - port

additionalProperties: false

examples:
  - |
    #include <dt-bindings/gpio/gpio.h>

    i2c {
        #address-cells = <1>;
        #size-cells = <0>;

        camera@1a {
            compatible = "sony,imx662aaqr";
            reg = <0x1a>;
            pinctrl-names = "default";
            pinctrl-0 = <&pinctrl_cam>;
            clocks = <&clk24m>;
            avdd-supply = <&reg_cam_avdd>;
            dvdd-supply = <&reg_cam_dvdd>;
            ovdd-supply = <&reg_cam_ovdd>;
            reset-gpios = <&gpio3 4 GPIO_ACTIVE_LOW>;

            port {
                imx662_out: endpoint {
                    data-lanes = <1 2 3 4>;
                    link-frequencies = /bits/ 64 <360000000>;
                    remote-endpoint = <&imx662_in>;
                };
            };
        };
    };
...
```

## Documentation/devicetree/bindings/perf/brcm,bcm2835-axiperf.yaml
```yaml
# SPDX-License-Identifier: (GPL-2.0-only OR BSD-2-Clause)
%YAML 1.2
---
$id: http://devicetree.org/schemas/perf/brcm,bcm2835-axiperf.yaml#
$schema: http://devicetree.org/meta-schemas/core.yaml#

title: Broadcom BCM2835/2711/2712 AXI Performance Monitor

maintainers:
  - Ian Rogers <irogers@google.com>

description:
  The Broadcom BCM2835 series (including BCM2711 and BCM2712) features hardware
  performance monitors on the AXI bus for evaluating memory bandwidth and
  system traffic. Two monitor register blocks are present, with the primary
  monitor evaluating the System fabric and the secondary monitor evaluating the
  VideoCore VPU fabric. This block is distinct from the BCM5301X AXI Trace
  Module.

properties:
  compatible:
    enum:
      - brcm,bcm2711-axiperf
      - brcm,bcm2712-axiperf
      - brcm,bcm2835-axiperf

  reg:
    items:
      - description: System monitor registers
      - description: VPU monitor registers

required:
  - compatible
  - reg

additionalProperties: false

examples:
  - |
    pmu@7e009800 {
        compatible = "brcm,bcm2835-axiperf";
        reg = <0x7e009800 0x100>,
              <0x7ee08000 0x100>;
    };
```

## Documentation/devicetree/bindings/serial/wkmic,wk2xxx.yaml
```yaml
# SPDX-License-Identifier: (GPL-2.0-only OR BSD-2-Clause)
%YAML 1.2
---
$id: http://devicetree.org/schemas/serial/wkmic,wk2xxx.yaml#
$schema: http://devicetree.org/meta-schemas/core.yaml#

title: WKmic WK2xxx SPI to UART bridge

maintainers:
  - EDATEC Technology Co., Ltd. <zjzhao@edatec.cn>

description:
  The WK2xxx family (WK2124, WK2132, WK2168, WK2202 and WK2204) are SPI to
  UART bridge ICs from WKmic (Chengdu Weikai Microelectronics). Each IC
  exposes two or four full-duplex UART channels with 256-byte RX/TX FIFOs
  through a single SPI slave interface and one interrupt line.

properties:
  compatible:
    enum:
      - wkmic,wk2124
      - wkmic,wk2132
      - wkmic,wk2168
      - wkmic,wk2202
      - wkmic,wk2204

  reg:
    maxItems: 1

  interrupts:
    description:
      When missing, the device driver uses polling instead.
    maxItems: 1

  clock-frequency:
    description:
      Crystal or external clock frequency for the IC in Hz. The WK2xxx has
      no internal clock, so this must match the connected crystal. Defaults
      to 11059200 Hz when the property is absent.
    minimum: 1
    maximum: 30000000

required:
  - compatible
  - reg

allOf:
  - $ref: /schemas/spi/spi-peripheral-props.yaml#
  - $ref: /schemas/serial/serial.yaml#
  - $ref: /schemas/serial/rs485.yaml#

unevaluatedProperties: false

examples:
  - |
    #include <dt-bindings/interrupt-controller/irq.h>
    spi {
        #address-cells = <1>;
        #size-cells = <0>;

        serial@0 {
            compatible = "wkmic,wk2132";
            reg = <0>;
            spi-max-frequency = <10000000>;
            clock-frequency = <11059200>;
            interrupt-parent = <&gpio>;
            interrupts = <24 IRQ_TYPE_LEVEL_LOW>;
        };
    };
```

## drivers/media/platform/broadcom/Kconfig
```kconfig
# SPDX-License-Identifier: GPL-2.0

comment "Broadcom BCM283x/BCM271x media platform drivers"

source "drivers/media/platform/broadcom/bcm2835-unicam/Kconfig"
source "drivers/media/platform/broadcom/bcm2835-isp/Kconfig"
```
