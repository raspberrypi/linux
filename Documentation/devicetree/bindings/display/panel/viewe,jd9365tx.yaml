## drivers/nexus/Kconfig
```kconfig
# Nexus device drivers - potpourri
#

menuconfig NEXUS
    bool "Enable Nexus hardware drivers"

if NEXUS
    menuconfig NEXUS_CAN
        depends on SPI
        bool "CAN Bus Drivers Present"
        default y
        if NEXUS_CAN
            menuconfig NEXUS_CAN0 
                depends on SPI
                bool "Enable system bus interface CAN0"
                default y
                if NEXUS_CAN0
                    config NEXUS_CAN0_BAUDRATE
                        int "Baudrate"
                        range 50000 500000
                        default 250000
                    config NEXUS_CAN0_SPIDEVNO
                        int "SPI Device Number"
                        range 0 5
                        default 1
                    config NEXUS_CAN0_SPICS
                        int "SPI Chip Select"
                        range 0 3
                        default 1
                    config NEXUS_CAN0_IRQ
                        int "SPI IRQ GPIO Number"
                        default 22
                        range 0 99
                endif # CAN0

            menuconfig NEXUS_CAN1 
                depends on SPI
                bool "Enable sensor bus interface CAN1"
                default n
                if NEXUS_CAN1
                    config NEXUS_CAN1_BAUDRATE
                        int "Baudrate"
                        range 50000 500000
                        default 250000
                    config NEXUS_CAN1_SPIDEVNO
                        int "SPI Device Number"
                        range 0 5
                        default 1
                    config NEXUS_CAN1_SPICS
                        int "SPI Chip Select"
                        range 0 3
                        default 1
                    config NEXUS_CAN1_IRQ
                        int "SPI IRQ GPIO Number"
                        default 13
                        range 0 99
                endif

            if NEXUS_CAN0 || NEXUS_CAN1
                config NEXUS_CAN_DEBUG
                    bool "Enable CAN Debug Flag on GPIO"
                    default n
                    if NEXUS_CAN_DEBUG
                        config NEXUS_CAN_DEBUG_GPIO
                        int "Debug GPIO"
                        default 22
                        range 0 99
                    endif
            endif
        endif # NEXUS_CAN

    menuconfig NEXUS_LCD
        depends on SPI
        bool "Enable LCD display"
        default n
        if NEXUS_LCD
            config NEXUS_LCD_SPIDEVNO
                int "SPI Device Number"
                range 0 5
                default 1
            config NEXUS_LCD_SPICS
                int "SPI Chip Select"
                range 0 3
                default 0
            config NEXUS_LCD_SPICLOCK
                int "SPI Clock Speed (Hz)"
                range   1000000 20000000
                default 10000000
            choice 
                prompt "Display Module Type"
                default NEXUS_LCD_TYPE_DEFAULT
                config  NEXUS_LCD_TYPE_DEFAULT
                    bool "Default Display Module"
                config NEXUS_LCD_TYPE_EXPERIMENTAL
                    bool "Experimental Display Module"
            endchoice
        endif 

    menuconfig NEXUS_KEYBOARD
        depends on I2C
        bool "Enable Keyboard"
        default n
        if NEXUS_KEYBOARD
            config NEXUS_KEYBOARD_I2CDEVNO
                int "I2C Device Number"
                range 0 20
            config NEXUS_KEYBOARD_I2CDEVADDR
                hex "I2C Device Address"
                default 0x44
               range 0 255
            choice
                prompt "Keyboard Type"
                default NEXUS_KEYBOARD_TYPE_DEFAULT
                config  NEXUS_KEYBOARD_TYPE_DEFAULT
                    bool "Default Keyboard"
                config  NEXUS_KEYBOARD_TYPE_EXPERIMENTAL
                    bool "Experimental Keyboard"
            endchoice
        endif

endif # Nexus

# vim: sw=4 ts=8 ai expandtab nobackup :
```

## drivers/staging/sferalabs/Kconfig
```kconfig
# SPDX-License-Identifier: GPL-2.0

source "drivers/staging/sferalabs/ionopi-v3/Kconfig"
```

## drivers/staging/sferalabs/ionopi-v3/Kconfig
```kconfig
config IONO_PI_V3
	tristate "Sfera Labs Iono Pi v3 support"
	help
	  Driver for the Sfera Labs Iono Pi v3 board.
```

## kernel/Kconfig.hz
```kconfig
# SPDX-License-Identifier: GPL-2.0-only
#
# Timer Interrupt Frequency Configuration
#

choice
	prompt "Timer frequency"
	default HZ_750
	help
	 Allows the configuration of the timer frequency. It is customary
	 to have the timer interrupt run at 1000 Hz but 100 Hz may be more
	 beneficial for servers and NUMA systems that do not need to have
	 a fast response for user interaction and that may experience bus
	 contention and cacheline bounces as a result of timer interrupts.
	 Note that the timer interrupt occurs on each processor in an SMP
	 environment leading to NR_CPUS * HZ number of timer interrupts
	 per second.


	config HZ_100
		bool "100 HZ"
	help
	  100 Hz is a typical choice for servers, SMP and NUMA systems
	  with lots of processors that may show reduced performance if
	  too many timer interrupts are occurring.

	config HZ_250
		bool "250 HZ"
	help
	 250 Hz is a good compromise choice allowing server performance
	 while also showing good interactive responsiveness even
	 on SMP and NUMA systems. If you are going to be using NTSC video
	 or multimedia, selected 300Hz instead.

	config HZ_300
		bool "300 HZ"
	help
	 300 Hz is a good compromise choice allowing server performance
	 while also showing good interactive responsiveness even
	 on SMP and NUMA systems and exactly dividing by both PAL and
	 NTSC frame rates for video and multimedia work.

	config HZ_500
		bool "500 HZ"
	help
	 500 Hz is a balanced timer frequency. Provides fast interactivity
	 on desktops with great smoothness without increasing CPU power
	 consumption and sacrificing the battery life on laptops.

	config HZ_750
		bool "750 HZ"
	help
	 750 Hz is a good timer frequency for desktops. Provides fast
	 interactivity with great smoothness without sacrificing too
	 much throughput.

	config HZ_833
		bool "833 HZ"
	help
	 833 Hz is the TT alternative to 1000 Hz. Choose 833 Hz
	 if you want a balance between latency and performance.

	config HZ_1000
		bool "1000 HZ"
	help
	 1000 Hz is the preferred choice for desktop systems and other
	 systems requiring fast interactive responses to events.

	config HZ_1666
		bool "1666 HZ"
	help
	 1666 Hz is for very high latency bound systems. Choose 1666 Hz
	 if you don't care about overall throughput or performance, but
	 you care more about latency (some realtime applications) require
	 low latency. The response and interactive processes with 1666 Hz
	 feel much snappier.

	config HZ_2000
		bool "2000 HZ"
	helps
	 BALLS 2 WALLZZZ

endchoice

config HZ
	int
	default 100 if HZ_100
	default 250 if HZ_250
	default 300 if HZ_300
	default 500 if HZ_500
	default 750 if HZ_750
	default 833 if HZ_833
	default 1000 if HZ_1000
	default 1666 if HZ_1666
	default 2000 if HZ_2000

config SCHED_HRTICK
	def_bool HIGH_RES_TIMERS
```
