## Documentation/devicetree/bindings/display/panel/panel-dsi.yaml
```yaml
# SPDX-License-Identifier: (GPL-2.0-only OR BSD-2-Clause)
%YAML 1.2
---
$id: http://devicetree.org/schemas/display/panel/panel-dsi.yaml#
$schema: http://devicetree.org/meta-schemas/core.yaml#

title: Generic MIPI DSI Panel

maintainers:
  - Timon Skerutsch <kernel@diodes-delight.com>

properties:
  compatible:
    description:
      Shall contain a panel specific compatible and "panel-dsi"
      in that order.
    items:
      - {}
      - const: panel-dsi

  dsi-color-format:
    description: |
      The color format used by the panel. Only DSI supported formats are allowed.
    enum:
      - RGB888
      - RGB666
      - RGB666_PACKED
      - RGB565

  port:
    $ref: /schemas/graph.yaml#/$defs/port-base
    unevaluatedProperties: false
    description:
      Panel MIPI DSI input

    properties:
      endpoint:
        $ref: /schemas/media/video-interfaces.yaml#
        unevaluatedProperties: false

        properties:
          data-lanes: true

        required:
          - data-lanes

  mode:
    description: |
      DSI mode flags. See DSI Specs for details.
      These are driver independent features of the DSI bus.
    $ref: /schemas/types.yaml#/definitions/string-array
    items:
      enum:
        - MODE_VIDEO
        - MODE_VIDEO_BURST
        - MODE_VIDEO_SYNC_PULSE
        - MODE_VIDEO_AUTO_VERT
        - MODE_VIDEO_HSE
        - MODE_VIDEO_NO_HFP
        - MODE_VIDEO_NO_HBP
        - MODE_VIDEO_NO_HSA
        - MODE_VSYNC_FLUSH
        - MODE_NO_EOT_PACKET
        - CLOCK_NON_CONTINUOUS
        - MODE_LPM
        - HS_PKT_END_ALIGNED

  reg:
    maxItems: 1

  backlight:
    $ref: panel-common.yaml#/properties/backlight

  enable-gpios:
    $ref: panel-common.yaml#/properties/enable-gpios

  width-mm: true

  height-mm: true

  panel-timing:
    $ref: panel-common.yaml#/properties/panel-timing

  power-supply: true

  reset-gpios:
    $ref: panel-common.yaml#/properties/reset-gpios

  ddc-i2c-bus:
    $ref: panel-common.yaml#/properties/ddc-i2c-bus

required:
  - panel-timing
  - reg
  - power-supply
  - dsi-color-format
  - port

additionalProperties: false

examples:
  - |
    dsi {
        #address-cells = <1>;
        #size-cells = <0>;

        panel@0 {
            compatible = "panel-mfgr,generic-dsi-panel","panel-dsi";
            power-supply = <&vcc_supply>;
            backlight = <&backlight>;
            dsi-color-format = "RGB888";
            reg = <0>;
            mode = "MODE_VIDEO", "MODE_VIDEO_BURST", "MODE_NO_EOT_PACKET";

            port {
                panel_dsi_port: endpoint {
                    data-lanes = <1 2>;
                    remote-endpoint = <&dsi_out>;
                };
            };

            panel-timing {
                clock-frequency = <9200000>;
                hactive = <800>;
                vactive = <480>;
                hfront-porch = <8>;
                hback-porch = <4>;
                hsync-len = <41>;
                vback-porch = <2>;
                vfront-porch = <4>;
                vsync-len = <10>;
            };
        };

    };

...
```

## Documentation/devicetree/bindings/input/touchscreen/jadard,jd9365tx.yaml
```yaml
# SPDX-License-Identifier: (GPL-2.0-only OR BSD-2-Clause)
%YAML 1.2
---
$id: http://devicetree.org/schemas/input/touchscreen/jadard,jd9365tx.yaml#
$schema: http://devicetree.org/meta-schemas/core.yaml#

title: Jadard JD9365TX in-cell touchscreen

maintainers:
  - Hefei <3066883572@qq.com>

description: |
  In-cell touch integrated with Jadard JD9365TX DSI panels. Many module FPCs
  expose only the I2C bus; some boards also wire an interrupt GPIO. The
  touch controller is commonly powered from the same rails as the panel.

allOf:
  - $ref: touchscreen.yaml#

properties:
  compatible:
    const: jadard,jd9365tx

  reg:
    maxItems: 1

  interrupts:
    maxItems: 1

  poll-interval: true

  vdd-supply:
    description: Analog / touch power supply

  iovcc-supply:
    description: Digital I/O power supply

  reset-gpios:
    maxItems: 1

required:
  - compatible
  - reg

unevaluatedProperties: false

examples:
  - |
    i2c {
        #address-cells = <1>;
        #size-cells = <0>;

        touchscreen@68 {
            compatible = "jadard,jd9365tx";
            reg = <0x68>;
            vdd-supply = <&reg_vdd>;
            iovcc-supply = <&reg_iovcc>;
            touchscreen-size-x = <720>;
            touchscreen-size-y = <1280>;
            poll-interval = <16>;
        };
    };
...
```

## Documentation/devicetree/bindings/leds/backlight/viewe,7kf82-backlight.yaml
```yaml
# SPDX-License-Identifier: (GPL-2.0-only OR BSD-2-Clause)
%YAML 1.2
---
$id: http://devicetree.org/schemas/leds/backlight/viewe,7kf82-backlight.yaml#
$schema: http://devicetree.org/meta-schemas/core.yaml#

title: VIEWE 7KF82 I2C panel backlight

maintainers:
  - Hefei <3066883572@qq.com>

description: |
  I2C backlight MCU used on the VIEWE 7KF82 DSI module. Protocol is device
  address 0x45, register 0x86, brightness 0..255. A discrete MCU part number
  is not exposed on the FPC silk; the binding is therefore keyed to the
  module.

allOf:
  - $ref: common.yaml#

properties:
  compatible:
    const: viewe,7kf82-backlight

  reg:
    maxItems: 1

required:
  - compatible
  - reg

unevaluatedProperties: false

examples:
  - |
    i2c {
        #address-cells = <1>;
        #size-cells = <0>;

        backlight@45 {
            compatible = "viewe,7kf82-backlight";
            reg = <0x45>;
            default-brightness = <200>;
        };
    };
...
```

## Documentation/devicetree/bindings/media/rpivid_hevc.yaml
```yaml
# SPDX-License-Identifier: GPL-2.0-only
%YAML 1.2
---
$id: http://devicetree.org/schemas/media/rpivid_hevc.yaml#
$schema: http://devicetree.org/meta-schemas/core.yaml#

title: Raspberry Pi HEVC Decoder

maintainers:
  - Raspberry Pi <kernel-list@raspberrypi.com>

description: |-
  The Camera Adaptation Layer (CAL) is a key component for image capture
  applications. The capture module provides the system interface and the
  processing capability to connect CSI2 image-sensor modules to the
  DRA72x device.

properties:
  compatible:
    enum:
      - raspberrypi,rpivid-vid-decoder

  reg:
    items:
      - description: The HEVC main register region
      - description: The Interrupt controller register region

  reg-names:
    items:
      - const: hevc
      - const: intc

  interrupts:
    maxItems: 1

  clocks:
    items:
      - description: The HEVC block clock

  clock-names:
    items:
      - const: hevc

required:
  - compatible
  - reg
  - reg-names
  - interrupts
  - clocks

additionalProperties: false

examples:
  - |
    #include <dt-bindings/interrupt-controller/arm-gic.h>

    soc {
        #address-cells = <2>;
        #size-cells = <1>;

        video-codec@7eb00000 {
            compatible = "raspberrypi,rpivid-vid-decoder";
            reg = <0x0 0x7eb00000 0x10000>,
                  <0x0 0x7eb10000 0x1000>;
            reg-names = "hevc",
                        "intc";

            interrupts = <GIC_SPI 98 IRQ_TYPE_LEVEL_HIGH>;

            clocks = <&clk 0>;
            clock-names = "hevc";
        };
    };

...
```
