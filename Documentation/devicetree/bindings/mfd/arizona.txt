## Documentation/devicetree/bindings/mfd/arizona.txt
```
Wolfson Arizona class audio SoCs

These devices are audio SoCs with extensive digital capabilites and a range
of analogue I/O.

Required properties:

  - compatible : One of the following chip-specific strings:
        "wlf,wm5102"
        "wlf,wm5110"
        "wlf,wm8997"
  - reg : I2C slave address when connected using I2C, chip select number when
    using SPI.

  - interrupts : The interrupt line the /IRQ signal for the device is
    connected to.
  - interrupt-controller : Arizona class devices contain interrupt controllers
    and may provide interrupt services to other devices.
  - interrupt-parent : The parent interrupt controller.
  - #interrupt-cells: the number of cells to describe an IRQ, this should be 2.
    The first cell is the IRQ number.
    The second cell is the flags, encoded as the trigger masks from
    Documentation/devicetree/bindings/interrupts.txt

  - gpio-controller : Indicates this device is a GPIO controller.
  - #gpio-cells : Must be 2. The first cell is the pin number and the
    second cell is used to specify optional parameters (currently unused).

  - AVDD-supply, DBVDD1-supply, DBVDD2-supply, DBVDD3-supply (wm5102, wm5110),
    CPVDD-supply, SPKVDDL-supply (wm5102, wm5110), SPKVDDR-supply (wm5102,
    wm5110), SPKVDD-supply (wm8997) : Power supplies for the device, as covered
    in Documentation/devicetree/bindings/regulator/regulator.txt

Optional properties:

  - wlf,reset : GPIO specifier for the GPIO controlling /RESET
  - wlf,ldoena : GPIO specifier for the GPIO controlling LDOENA

  - wlf,micd-ranges : Microphone detection level and key configuration, this
    field can be of variable length but should always be a multiple of 2 cells
    long, each two cell group represents one button configuration
    The first cell is the maximum impedance for this button in ohms
    The second cell the key that should be reported to the input layer
  - wlf,micd-configs : Headset polarity configurations, the field can be of
    variable length but should always be a multiple of 3 cells long, each two
    cell group represents one polarity configration
    The first cell is the accessory detection source as per the ACCDET_SRC bits
    in the ACCESSORY_DETECT_MODE_1 register
    The second cell represents the MICBIAS to be used as per the MICD_BIAS_SRC
    bits in the MIC_DETECT_1 register
    The third cell represents the value of the micd-pol-gpio pin, a non-zero
    value indicates this should be on

  - wlf,gpio-defaults : A list of GPIO configuration register values. If
    absent, no configuration of these registers is performed. If any
    entry has a value that is out of range for a 16 bit register then
    the chip default will be used.  If present exactly five values must
    be specified.

  - wlf,inmode : A list of INn_MODE register values, where n is the number
    of input signals. Valid values are 0 (Differential), 1 (Single-ended) and
    2 (Digital Microphone). If absent, INn_MODE registers set to 0 by default.
    If present, values must be specified less than or equal to the number of
    input singals. If values less than the number of input signals, elements
    that has not been specifed are set to 0 by default.

  - DCVDD-supply, MICVDD-supply : Power supplies, only need to be specified if
    they are being externally supplied. As covered in
    Documentation/devicetree/bindings/regulator/regulator.txt

Optional subnodes:
  - ldo1 : Initial data for the LDO1 regulator, as covered in
    Documentation/devicetree/bindings/regulator/regulator.txt
  - micvdd : Initial data for the MICVDD regulator, as covered in
    Documentation/devicetree/bindings/regulator/regulator.txt

Example:

codec: wm5102@1a {
	compatible = "wlf,wm5102";
	reg = <0x1a>;
	interrupts = <347>;
	interrupt-controller;
	#interrupt-cells = <2>;
        interrupt-parent = <&gic>;

	gpio-controller;
	#gpio-cells = <2>;

	wlf,micd-ranges = <
		11 0x100
		28 0x101
		54 0x102
		100 0x103
		186 0x104
		430 0x105
	>;
	wlf,micd-configs = <
		0x1 1 0
		0x0 2 1
	>;

	wlf,gpio-defaults = <
		0x00000000 /* AIF1TXLRCLK */
		0xffffffff
		0xffffffff
		0xffffffff
		0xffffffff
	>;
};
```

## Documentation/devicetree/bindings/misc/brcm,bcm2835-smi-dev.txt
```
* Broadcom BCM2835 SMI character device driver.

SMI or secondary memory interface is a peripheral specific to certain Broadcom
SOCs, and is helpful for talking to things like parallel-interface displays
and NAND flashes (in fact, most things with a parallel register interface).

This driver adds a character device which provides a user-space interface to
an instance of the SMI driver.

Required properties:
- compatible: "brcm,bcm2835-smi-dev"
- smi_handle: a phandle to the smi node.

Optional properties:
- None.
```

## Documentation/devicetree/bindings/misc/brcm,bcm2835-smi.txt
```
* Broadcom BCM2835 SMI driver.

SMI or secondary memory interface is a peripheral specific to certain Broadcom
SOCs, and is helpful for talking to things like parallel-interface displays
and NAND flashes (in fact, most things with a parallel register interface).

Required properties:
- compatible: "brcm,bcm2835-smi"
- reg: Should contain location and length of SMI registers and SMI clkman regs
- interrupts: *the* SMI interrupt.
- pinctrl-names: should be "default".
- pinctrl-0: the phandle of the gpio pin node.
- brcm,smi-clock-source: the clock source for clkman
- brcm,smi-clock-divisor: the integer clock divisor for clkman
- dmas: the dma controller phandle and the DREQ number (4 on a 2835)
- dma-names: the name used by the driver to request its channel.
  Should be "rx-tx".

Optional properties:
- None.

Examples:

8 data pin configuration:

smi: smi@7e600000 {
	compatible = "brcm,bcm2835-smi";
	reg = <0x7e600000 0x44>, <0x7e1010b0 0x8>;
	interrupts = <2 16>;
	pinctrl-names = "default";
	pinctrl-0 = <&smi_pins>;
	brcm,smi-clock-source = <6>;
	brcm,smi-clock-divisor = <4>;
	dmas = <&dma 4>;
	dma-names = "rx-tx";

	status = "okay";
};

smi_pins: smi_pins {
	brcm,pins = <2 3 4 5 6 7 8 9 10 11 12 13 14 15>;
	/* Alt 1: SMI */
	brcm,function = <5 5 5 5 5 5 5 5 5 5 5 5 5 5>;
	/* /CS, /WE and /OE are pulled high, as they are
	   generally active low signals */
	brcm,pull = <2 2 2 2 2 2 0 0 0 0 0 0 0 0>;
};
```

## Documentation/devicetree/bindings/mtd/brcm,bcm2835-smi-nand.txt
```
* BCM2835 SMI NAND flash

This driver is a shim between the BCM2835 SMI driver (SMI is a peripheral for
talking to parallel register interfaces) and Linux's MTD layer.

Required properties:
- compatible: "brcm,bcm2835-smi-nand"
- status: "okay"

Optional properties:
- partition@n, where n is an integer from a consecutive sequence starting at 0
	- Difficult to store partition table on NAND device - normally put it
	in the source code, kernel bootparams, or device tree (the best way!)
	- Sub-properties:
		- label: the partition name, as shown by mtdinfo /dev/mtd*
		- reg: the size and offset of this partition.
		- (optional) read-only: an empty property flagging as read only

Example:

nand: flash@0 {
	compatible = "brcm,bcm2835-smi-nand";
	status = "okay";

	partition@0 {
		label = "stage2";
		// 128k
		reg = <0 0x20000>;
		read-only;
	};
	partition@1 {
		label = "firmware";
		// 16M
		reg = <0x20000 0x1000000>;
		read-only;
	};
	partition@2 {
		label = "root";
		// 2G
		reg = <0x1020000 0x80000000>;
	};
};
```

## Documentation/devicetree/bindings/nvmem/raspberrypi,bcm2835-customer-otp.txt
```
Customer OTP Memory for Raspberry Pi

Required properties :
- compatible     : Should be "raspberrypi,bcm2835-customer-otp"
- firmware       : Reference to the RPi firmware device node.
- #address-cells : Should be 1
- #size-cells    : Should be 1

See nvmem.txt for more information.

Example:

	customer_otp: otp {
		compatible = "raspberrypi,bcm2835-customer-otp";
		firmware = <&firmware>;
		#address-cells = <1>;
		#size-cells = <1>;
	};
```

## Documentation/devicetree/bindings/pwm/pwm-rp1.yaml
```yaml
# SPDX-License-Identifier: (GPL-2.0-only OR BSD-2-Clause)
%YAML 1.2
---
$id: http://devicetree.org/schemas/pwm/pwm-rp1.yaml#
$schema: http://devicetree.org/meta-schemas/core.yaml#

title: Raspberry Pi RP1 PWM controller

maintainers:
  - Naushir Patuck <naush@raspberrypi.com>

properties:
  compatible:
    enum:
      - raspberrypi,rp1-pwm

  reg:
    maxItems: 1

  "#pwm-cells":
    const: 3

required:
  - compatible
  - reg
  - clocks
  - "#pwm-cells"

additionalProperties: false

examples:
  - |
    pwm0: pwm@98000 {
      compatible = "raspberrypi,rp1-pwm";
      reg = <0x0 0x98000  0x0 0x100>;
      clocks = <&rp1_sys>;
      #pwm-cells = <3>;
    };
```

## Documentation/devicetree/bindings/rtc/rtc-rpi.txt
```
* Raspberry Pi RTC

This is a Linux interface to an RTC managed by firmware, hence it's
virtual from a Linux perspective.

The interface uses the firmware mailbox api to access the RTC registers.

Required properties:
compatible: should be "raspberrypi,rpi-rtc"
firmware:   Reference to the RPi firmware device node.

Example:

	rpi_rtc: rpi_rtc {
		compatible = "raspberrypi,rpi-rtc";
		firmware = <&firmware>;
	};
```

## Documentation/devicetree/bindings/spi/raspberrypi,rp2040-gpio-bridge.yaml
```yaml
# SPDX-License-Identifier: (GPL-2.0-only OR BSD-2-Clause)
%YAML 1.2
---
$id: http://devicetree.org/schemas/spi/raspberrypi,rp2040-gpio-bridge.yaml#
$schema: http://devicetree.org/meta-schemas/core.yaml#

title: Raspberry Pi RP2040 GPIO Bridge

maintainers:
  - Raspberry Pi <kernel-list@raspberrypi.com>

description: |-
  The Raspberry Pi PR2040 GPIO bridge can be used as a GPIO expander and
  Tx-only SPI master.

properties:
  reg:
    description: I2C slave address
    const: 0x40

  compatible:
    const: raspberrypi,rp2040-gpio-bridge

  power-supply:
    description: Phandle to the regulator that powers the RP2040.

  '#address-cells':
    const: 1

  '#size-cells':
    const: 0

  '#gpio-cells':
    const: 2

  gpio-controller: true

  fast_xfer_requires_i2c_lock:
    description: Set if I2C bus should be locked during fast transfer.

  fast_xfer_recv_gpio_base:
    description: RP2040 GPIO base for fast transfer pair.

  fast_xfer-gpios:
    description: RP1 GPIOs to use for fast transfer clock and data.

required:
  - reg
  - compatible
  - power-supply
  - '#gpio-cells'
  - gpio-controller

additionalProperties: false

examples:
  - |
    i2c {
      #address-cells = <1>;
      #size-cells = <0>;

      spi@40 {
        reg = <0x40>;
        compatible = "raspberrypi,rp2040-gpio-bridge";
        status = "disabled";
        #address-cells = <1>;
        #size-cells = <0>;

        power-supply = <&cam_dummy_reg>;

        #gpio-cells = <2>;
        gpio-controller;
      };
    };

...
```

## Kconfig
```kconfig
config SND_BCM2708_SOC_DIONAUDIO_KIWI
	tristate "Support for Dion Audio KIWI STREAMER"
	depends on SND_BCM2708_SOC_I2S || SND_BCM2835_SOC_I2S
	select SND_SOC_PCM1794A
	help
	  Say Y or M if you want to add support for Dion Audio KIWI.
```

## arch/arm/configs/bcm2709_sdcard_defconfig
```kconfig
# CONFIG_ARM_PATCH_PHYS_VIRT is not set
CONFIG_PHYS_OFFSET=0x0
CONFIG_LOCALVERSION="-sdcard"
# CONFIG_LOCALVERSION_AUTO is not set
# CONFIG_SWAP is not set
CONFIG_SYSVIPC=y
CONFIG_POSIX_MQUEUE=y
CONFIG_FHANDLE=y
CONFIG_AUDIT=y
CONFIG_NO_HZ=y
CONFIG_HIGH_RES_TIMERS=y
CONFIG_BSD_PROCESS_ACCT=y
CONFIG_BSD_PROCESS_ACCT_V3=y
CONFIG_TASKSTATS=y
CONFIG_TASK_DELAY_ACCT=y
CONFIG_TASK_XACCT=y
CONFIG_TASK_IO_ACCOUNTING=y
CONFIG_IKCONFIG=y
CONFIG_IKCONFIG_PROC=y
CONFIG_CGROUP_FREEZER=y
CONFIG_CGROUP_DEVICE=y
CONFIG_CGROUP_CPUACCT=y
CONFIG_RESOURCE_COUNTERS=y
CONFIG_MEMCG=y
CONFIG_BLK_CGROUP=y
CONFIG_NAMESPACES=y
CONFIG_SCHED_AUTOGROUP=y
CONFIG_RELAY=y
CONFIG_BLK_DEV_INITRD=y
CONFIG_EMBEDDED=y
# CONFIG_PERF_EVENTS is not set
# CONFIG_COMPAT_BRK is not set
CONFIG_PROFILING=y
CONFIG_JUMP_LABEL=y
CONFIG_BLK_DEV_BSGLIB=y
CONFIG_BLK_DEV_THROTTLING=y
CONFIG_CFQ_GROUP_IOSCHED=y
CONFIG_ARCH_BCM2709=y
# CONFIG_CACHE_L2X0 is not set
CONFIG_SMP=y
CONFIG_HAVE_ARM_ARCH_TIMER=y
CONFIG_HOTPLUG_CPU=y
CONFIG_PREEMPT=y
CONFIG_AEABI=y
CONFIG_CMA=y
CONFIG_UACCESS_WITH_MEMCPY=y
CONFIG_SECCOMP=y
CONFIG_ZBOOT_ROM_TEXT=0x0
CONFIG_ZBOOT_ROM_BSS=0x0
CONFIG_CMDLINE="console=ttyAMA0,115200 kgdboc=ttyAMA0,115200 root=/dev/mmcblk0p2 rootfstype=ext4 rootwait"
CONFIG_CPU_IDLE=y
CONFIG_VFP=y
# CONFIG_COREDUMP is not set
# CONFIG_SUSPEND is not set
CONFIG_NET=y
CONFIG_UNIX=y
CONFIG_CGROUP_NET_CLASSID=y
# CONFIG_WIRELESS is not set
CONFIG_DEVTMPFS=y
CONFIG_DEVTMPFS_MOUNT=y
CONFIG_DMA_CMA=y
CONFIG_CMA_SIZE_MBYTES=8
CONFIG_BLK_DEV_LOOP=y
CONFIG_BLK_DEV_RAM=y
# CONFIG_INPUT_MOUSEDEV_PSAUX is not set
# CONFIG_INPUT_KEYBOARD is not set
# CONFIG_INPUT_MOUSE is not set
# CONFIG_SERIO is not set
# CONFIG_LEGACY_PTYS is not set
# CONFIG_DEVKMEM is not set
CONFIG_SERIAL_AMBA_PL011=y
CONFIG_SERIAL_AMBA_PL011_CONSOLE=y
CONFIG_TTY_PRINTK=y
# CONFIG_HW_RANDOM is not set
CONFIG_BRCM_CHAR_DRIVERS=y
CONFIG_BCM_VC_CMA=y
CONFIG_GPIO_SYSFS=y
# CONFIG_HWMON is not set
CONFIG_FB=y
CONFIG_FB_BCM2708=y
CONFIG_FRAMEBUFFER_CONSOLE=y
# CONFIG_HID is not set
# CONFIG_USB_SUPPORT is not set
CONFIG_MMC=y
CONFIG_MMC_BLOCK_MINORS=32
CONFIG_MMC_SDHCI=y
CONFIG_MMC_SDHCI_PLTFM=y
CONFIG_MMC_BCM2835=y
CONFIG_MMC_BCM2835_DMA=y
CONFIG_DMADEVICES=y
CONFIG_DMA_BCM2708=y
# CONFIG_IOMMU_SUPPORT is not set
CONFIG_EXT4_FS=y
CONFIG_EXT4_FS_POSIX_ACL=y
CONFIG_EXT4_FS_SECURITY=y
CONFIG_FANOTIFY=y
CONFIG_FSCACHE=y
CONFIG_FSCACHE_STATS=y
CONFIG_FSCACHE_HISTOGRAM=y
CONFIG_CACHEFILES=y
CONFIG_MSDOS_FS=y
CONFIG_VFAT_FS=y
CONFIG_FAT_DEFAULT_IOCHARSET="ascii"
CONFIG_TMPFS=y
CONFIG_TMPFS_POSIX_ACL=y
CONFIG_CONFIGFS_FS=y
# CONFIG_MISC_FILESYSTEMS is not set
# CONFIG_NETWORK_FILESYSTEMS is not set
CONFIG_NLS_DEFAULT="utf8"
CONFIG_NLS_CODEPAGE_437=y
CONFIG_NLS_ASCII=y
CONFIG_PRINTK_TIME=y
CONFIG_BOOT_PRINTK_DELAY=y
CONFIG_DEBUG_FS=y
CONFIG_MAGIC_SYSRQ=y
CONFIG_DETECT_HUNG_TASK=y
CONFIG_TIMER_STATS=y
# CONFIG_DEBUG_PREEMPT is not set
CONFIG_DEBUG_LL=y
CONFIG_EARLY_PRINTK=y
CONFIG_KEYS=y
CONFIG_CRYPTO_CBC=y
CONFIG_CRYPTO_AES=y
CONFIG_CRYPTO_DES=y
# CONFIG_CRYPTO_ANSI_CPRNG is not set
# CONFIG_CRYPTO_HW is not set
CONFIG_CRC_ITU_T=y
CONFIG_LIBCRC32C=y
CONFIG_AVERAGE=y
```

## arch/arm/configs/bcm2709_small_defconfig
```kconfig
CONFIG_LOCALVERSION="-small"
# CONFIG_LOCALVERSION_AUTO is not set
# CONFIG_SWAP is not set
CONFIG_SYSVIPC=y
CONFIG_HIGH_RES_TIMERS=y
CONFIG_LOG_BUF_SHIFT=16
CONFIG_BLK_DEV_INITRD=y
CONFIG_INITRAMFS_SOURCE="../target_fs"
CONFIG_SLAB=y
# CONFIG_BLK_DEV_BSG is not set
# CONFIG_IOSCHED_CFQ is not set
CONFIG_ARCH_BCM2709=y
# CONFIG_BCM2708_GPIO is not set
# CONFIG_BCM2708_VCMEM is not set
CONFIG_ARM_THUMBEE=y
# CONFIG_SWP_EMULATE is not set
# CONFIG_CACHE_L2X0 is not set
CONFIG_ARM_ERRATA_720789=y
CONFIG_SMP=y
CONFIG_SCHED_MC=y
CONFIG_SCHED_SMT=y
CONFIG_HOTPLUG_CPU=y
CONFIG_PREEMPT=y
CONFIG_AEABI=y
CONFIG_HIGHMEM=y
CONFIG_HIGHPTE=y
# CONFIG_COMPACTION is not set
CONFIG_ZBOOT_ROM_TEXT=0x0
CONFIG_ZBOOT_ROM_BSS=0x0
CONFIG_CMDLINE="earlyprintk=ttyAMA0,19200 loglevel=9 console=ttyAMA0,19200"
CONFIG_AUTO_ZRELADDR=y
CONFIG_BINFMT_MISC=y
# CONFIG_SUSPEND is not set
# CONFIG_UEVENT_HELPER is not set
# CONFIG_FIRMWARE_IN_KERNEL is not set
# CONFIG_INPUT_MOUSEDEV_PSAUX is not set
# CONFIG_INPUT_KEYBOARD is not set
# CONFIG_INPUT_MOUSE is not set
# CONFIG_SERIO is not set
# CONFIG_LEGACY_PTYS is not set
# CONFIG_DEVKMEM is not set
CONFIG_SERIAL_AMBA_PL011=y
CONFIG_SERIAL_AMBA_PL011_CONSOLE=y
# CONFIG_HW_RANDOM is not set
# CONFIG_HWMON is not set
# CONFIG_HID is not set
# CONFIG_USB_SUPPORT is not set
# CONFIG_IOMMU_SUPPORT is not set
CONFIG_AUTOFS4_FS=y
# CONFIG_MISC_FILESYSTEMS is not set
CONFIG_PRINTK_TIME=y
CONFIG_FRAME_WARN=4096
CONFIG_MAGIC_SYSRQ=y
CONFIG_DEBUG_KERNEL=y
CONFIG_RCU_CPU_STALL_TIMEOUT=60
# CONFIG_FTRACE is not set
# CONFIG_ARM_UNWIND is not set
CONFIG_DEBUG_LL=y
CONFIG_EARLY_PRINTK=y
CONFIG_CRC16=y
CONFIG_CRC_ITU_T=y
```
