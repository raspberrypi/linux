## drivers/char/broadcom/Kconfig
```kconfig
#
# Broadcom char driver config
#

menuconfig BRCM_CHAR_DRIVERS
	bool "Broadcom Char Drivers"
	help
	  Broadcom's char drivers

if BRCM_CHAR_DRIVERS

config BCM2708_VCMEM
	bool "Videocore Memory"
        default y
        help
          Helper for videocore memory access and total size allocation.

config BCM_VCIO
	tristate "Mailbox userspace access"
	depends on BCM2835_MBOX
	help
	  Gives access to the mailbox property channel from userspace.

endif

config BCM2835_SMI_DEV
	tristate "Character device driver for BCM2835 Secondary Memory Interface"
	depends on BCM2835_SMI
	default m
	help
		This driver provides a character device interface (ioctl + read/write) to
		Broadcom's Secondary Memory interface. The low-level functionality is provided
		by the SMI driver itself.
```

## drivers/crypto/loongson/Kconfig
```kconfig
config CRYPTO_DEV_LOONGSON_RNG
	tristate "Support for Loongson RNG Driver"
	depends on MFD_LOONGSON_SE
	select CRYPTO_RNG
	help
	  Support for Loongson RNG Driver.
```

## drivers/gpio/exercise-3-gpio/Kconfig
```kconfig
# SPDX-License-Identifier: GPL-2.0

menuconfig GPIO_EXERCISE_RUST
	bool "Rust gpio-led exerscise in rpbi4B"
	depends on RUST
	help
	  You can build sample Rust kernel code here.

	  If unsure, say N.

if GPIO_EXERCISE_RUST

config GPIO_LED_SAMPLE
	tristate "Led_rpbi4B"
	help
	  This option builds the Rust gpio rpbi4B module sample in C.
	  To compile this as a module, choose M here:
	  If unsure, say N.

config GPIO_LED_RUST
	tristate "Led_rpbi4B in Rust"
	help
	  This option builds the Rust gpio rpbi4B module sample in C.
	  To compile this as a module, choose M here:
	  If unsure, say N.

endif # GPIO_EXERCISE_RUST
```
