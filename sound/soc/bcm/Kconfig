## sound/soc/bcm/Kconfig
```kconfig
# SPDX-License-Identifier: GPL-2.0-only
config SND_BCM2835_SOC_I2S
	tristate "SoC Audio support for the Broadcom BCM2835 I2S module"
	depends on ARCH_BCM2835 || COMPILE_TEST
	select SND_SOC_GENERIC_DMAENGINE_PCM
	select REGMAP_MMIO
	help
	  Say Y or M if you want to add support for codecs attached to
	  the BCM2835 I2S interface. You will also need
	  to select the audio interfaces to support below.

config SND_SOC_CYGNUS
	tristate "SoC platform audio for Broadcom Cygnus chips"
	depends on ARCH_BCM_CYGNUS || COMPILE_TEST
	help
	  Say Y if you want to add support for ASoC audio on Broadcom
	  Cygnus chips (bcm958300, bcm958305, bcm911360)

	  If you don't know what to do here, say N.

config SND_BCM63XX_I2S_WHISTLER
	tristate "SoC Audio support for the Broadcom BCM63XX I2S module"
	select REGMAP_MMIO
	help
	  Say Y if you want to add support for ASoC audio on Broadcom
	  DSL/PON chips (bcm63158, bcm63178)

	  If you don't know what to do here, say N

config SND_BCM2708_SOC_CHIPDIP_DAC
         tristate "Support for the ChipDip DAC"
         help
          Say Y or M if you want to add support for the ChipDip DAC soundcard

config SND_BCM2708_SOC_GOOGLEVOICEHAT_SOUNDCARD
	tristate "Support for Google voiceHAT soundcard"
	select SND_SOC_VOICEHAT
	select SND_RPI_SIMPLE_SOUNDCARD
	help
          Say Y or M if you want to add support for voiceHAT soundcard.

config SND_BCM2708_SOC_HIFIBERRY_DAC
        tristate "Support for HifiBerry DAC"
        select SND_SOC_PCM5102A
        select SND_RPI_SIMPLE_SOUNDCARD
        help
         Say Y or M if you want to add support for HifiBerry DAC.

config SND_BCM2708_SOC_HIFIBERRY_DACPLUS
        tristate "Support for HifiBerry DAC+"
        select SND_SOC_PCM512x
        select SND_SOC_TPA6130A2
        select COMMON_CLK_HIFIBERRY_DACPRO
        help
         Say Y or M if you want to add support for HifiBerry DAC+.

config SND_BCM2708_SOC_HIFIBERRY_DACPLUSHD
        tristate "Support for HifiBerry DAC+ HD"
        select SND_SOC_PCM179X_I2C
        select COMMON_CLK_HIFIBERRY_DACPLUSHD
        help
         Say Y or M if you want to add support for HifiBerry DAC+ HD.

config SND_BCM2708_SOC_HIFIBERRY_DACPLUSADC
        tristate "Support for HifiBerry DAC+ADC"
        select SND_SOC_PCM512x_I2C
	select SND_SOC_DMIC
        select COMMON_CLK_HIFIBERRY_DACPRO
        help
         Say Y or M if you want to add support for HifiBerry DAC+ADC.

config SND_BCM2708_SOC_HIFIBERRY_DACPLUSADCPRO
        tristate "Support for HifiBerry DAC+ADC PRO"
        select SND_SOC_PCM512x_I2C
        select SND_SOC_PCM186X_I2C
        select SND_SOC_TPA6130A2
        select COMMON_CLK_HIFIBERRY_DACPRO
        help
         Say Y or M if you want to add support for HifiBerry DAC+ADC PRO.

config SND_BCM2708_SOC_HIFIBERRY_DACPLUSDSP
        tristate "Support for HifiBerry DAC+DSP"
	select SND_RPI_SIMPLE_SOUNDCARD
        help
         Say Y or M if you want to add support for HifiBerry DSP-DAC.

config SND_BCM2708_SOC_HIFIBERRY_DIGI
        tristate "Support for HifiBerry Digi"
        select SND_SOC_WM8804
        help
         Say Y or M if you want to add support for HifiBerry Digi S/PDIF output board.

config SND_BCM2708_SOC_HIFIBERRY_AMP
        tristate "Support for the HifiBerry Amp"
        select SND_SOC_TAS5713
        select SND_RPI_SIMPLE_SOUNDCARD
        help
         Say Y or M if you want to add support for the HifiBerry Amp amplifier board.

config SND_BCM2708_SOC_PIFI_40
         tristate "Support for the PiFi-40 amp"
         select SND_SOC_TAS571X
         select SND_PIFI_40
         help
          Say Y or M if you want to add support for the PiFi40 amp board

config SND_BCM2708_SOC_RPI_CIRRUS
        tristate "Support for Cirrus Logic Audio Card"
        select SND_SOC_WM5102
        select SND_SOC_WM8804
        help
         Say Y or M if you want to add support for the Wolfson and
         Cirrus Logic audio cards.

config SND_BCM2708_SOC_RPI_DAC
        tristate "Support for RPi-DAC"
        select SND_SOC_PCM1794A
        select SND_RPI_SIMPLE_SOUNDCARD
        help
         Say Y or M if you want to add support for RPi-DAC.

config SND_BCM2708_SOC_RPI_PROTO
	tristate "Support for Rpi-PROTO"
	select SND_SOC_WM8731_I2C
	help
	  Say Y or M if you want to add support for Audio Codec Board PROTO (WM8731).

config SND_BCM2708_SOC_JUSTBOOM_BOTH
	tristate "Support for simultaneous JustBoom Digi and JustBoom DAC"
	select SND_SOC_WM8804
	select SND_SOC_PCM512x
	help
		Say Y or M if you want to add support for simultaneous
		JustBoom Digi and JustBoom DAC.

		This is not the right choice if you only have one but both of
		these cards.

config SND_BCM2708_SOC_JUSTBOOM_DAC
	tristate "Support for JustBoom DAC"
	select SND_SOC_PCM512x
	help
	  Say Y or M if you want to add support for JustBoom DAC.

config SND_BCM2708_SOC_JUSTBOOM_DIGI
	tristate "Support for JustBoom Digi"
	select SND_SOC_WM8804
        select SND_RPI_WM8804_SOUNDCARD
	help
	  Say Y or M if you want to add support for JustBoom Digi.

config SND_BCM2708_SOC_IQAUDIO_CODEC
	tristate "Support for IQaudIO-CODEC"
	select SND_SOC_DA7213
	help
	  Say Y or M if you want to add support for IQaudIO-CODEC.

config SND_BCM2708_SOC_IQAUDIO_DAC
	tristate "Support for IQaudIO-DAC"
	select SND_SOC_PCM512x_I2C
	help
	  Say Y or M if you want to add support for IQaudIO-DAC.

config SND_BCM2708_SOC_IQAUDIO_DIGI
	tristate "Support for IQAudIO Digi"
	select SND_SOC_WM8804
	select SND_RPI_WM8804_SOUNDCARD
	help
	  Say Y or M if you want to add support for IQAudIO Digital IO board.

config SND_BCM2708_SOC_I_SABRE_Q2M
        tristate "Support for Audiophonics I-Sabre Q2M DAC"
        select SND_SOC_I_SABRE_CODEC
        help
        Say Y or M if you want to add support for Audiophonics I-SABRE Q2M DAC

config SND_BCM2708_SOC_ADAU1977_ADC
	tristate "Support for ADAU1977 ADC"
	select SND_SOC_ADAU1977_I2C
	select SND_RPI_SIMPLE_SOUNDCARD
	help
	  Say Y or M if you want to add support for ADAU1977 ADC.

config SND_AUDIOINJECTOR_PI_SOUNDCARD
	tristate "Support for audioinjector.net Pi add on soundcard"
	select SND_SOC_WM8731_I2C
	help
	  Say Y or M if you want to add support for audioinjector.net Pi Hat

config SND_AUDIOINJECTOR_OCTO_SOUNDCARD
	tristate "Support for audioinjector.net Octo channel (Hat) soundcard"
	select SND_SOC_CS42XX8_I2C
	help
	  Say Y or M if you want to add support for audioinjector.net octo add on

config SND_AUDIOINJECTOR_ISOLATED_SOUNDCARD
	tristate "Support for audioinjector.net isolated DAC and ADC soundcard"
	select SND_SOC_CS4271_I2C
	help
	  Say Y or M if you want to add support for audioinjector.net isolated soundcard

config SND_AUDIOSENSE_PI
	tristate "Support for AudioSense Add-On Soundcard"
	select SND_SOC_TLV320AIC32X4_I2C
	help
	  Say Y or M if you want to add support for tlv320aic32x4 add-on

config SND_DIGIDAC1_SOUNDCARD
        tristate "Support for Red Rocks Audio DigiDAC1"
        select SND_SOC_WM8804
        select SND_SOC_WM8741
        help
         Say Y or M if you want to add support for Red Rocks Audio DigiDAC1 board.

config SND_BCM2708_SOC_DIONAUDIO_LOCO
	tristate "Support for Dion Audio LOCO DAC-AMP"
	select SND_SOC_PCM5102a
	help
	  Say Y or M if you want to add support for Dion Audio LOCO.

config SND_BCM2708_SOC_DIONAUDIO_LOCO_V2
	tristate "Support for Dion Audio LOCO-V2 DAC-AMP"
	select SND_SOC_PCM5122
	help
	  Say Y or M if you want to add support for Dion Audio LOCO-V2.

config SND_BCM2708_SOC_ALLO_PIANO_DAC
	tristate "Support for Allo Piano DAC"
	select SND_SOC_PCM512x_I2C
	help
	  Say Y or M if you want to add support for Allo Piano DAC.

config SND_BCM2708_SOC_ALLO_PIANO_DAC_PLUS
	tristate "Support for Allo Piano DAC Plus"
	select SND_SOC_PCM512x_I2C
	help
	  Say Y or M if you want to add support for Allo Piano DAC Plus.

config SND_BCM2708_SOC_ALLO_BOSS_DAC
	tristate "Support for Allo Boss DAC"
	select SND_SOC_PCM512x_I2C
	select COMMON_CLK_HIFIBERRY_DACPRO
	help
	  Say Y or M if you want to add support for Allo Boss DAC.

config SND_BCM2708_SOC_ALLO_BOSS2_DAC
	tristate "Support for Allo Boss2 DAC"
	depends on I2C
	select REGMAP_I2C
	select SND_AUDIO_GRAPH_CARD
	help
	  Say Y or M if you want to add support for Allo Boss2 DAC.

config SND_BCM2708_SOC_ALLO_DIGIONE
	tristate "Support for Allo DigiOne"
	select SND_SOC_WM8804
	select SND_RPI_WM8804_SOUNDCARD
	help
	  Say Y or M if you want to add support for Allo DigiOne.

config SND_BCM2708_SOC_ALLO_KATANA_DAC
	tristate "Support for Allo Katana DAC"
	depends on I2C
	select REGMAP_I2C
	select SND_AUDIO_GRAPH_CARD
	help
	  Say Y or M if you want to add support for Allo Katana DAC.

config SND_BCM2708_SOC_FE_PI_AUDIO
	tristate "Support for Fe-Pi-Audio"
	select SND_SOC_SGTL5000
	help
	  Say Y or M if you want to add support for Fe-Pi-Audio.

config SND_PISOUND
	tristate "Support for Blokas Labs pisound"
	select SND_RAWMIDI
	help
	  Say Y or M if you want to add support for Blokas Labs pisound.

config SND_RPI_SIMPLE_SOUNDCARD
	tristate "Support for Raspberry Pi simple soundcards"
	help
	  Say Y or M if you want to add support Raspbery Pi simple soundcards

config SND_RPI_WM8804_SOUNDCARD
	tristate "Support for Raspberry Pi generic WM8804 soundcards"
	help
	  Say Y or M if you want to add support for the Raspberry Pi
          generic driver for WM8804 based soundcards.

config SND_DACBERRY400
	tristate "Support for DACBERRY400 Soundcard"
	select SND_SOC_TLV320AIC3X_I2C
	help
	  Say Y or M if you want to add support for tlv320aic3x add-on
```

## sound/soc/raspberrypi/Kconfig
```kconfig
# SPDX-License-Identifier: GPL-2.0-only
config SND_RP1_AUDIO_OUT
	tristate "PWM Audio Out from RP1"
	select SND_SOC_GENERIC_DMAENGINE_PCM
	select SND_SOC_SPDIF
	help
	 Say Y or M if you want to add support for PWM digital
	 audio output from a Raspberry Pi 5, 500 or CM5.

	 Output is from RP1 GPIOs pins 12 and 13 only, and additional
	 components will be needed. It may be useful when HDMI, I2S
	 or USB audio devices are unavailable, or for compatibility.
```

## tools/testing/kunit/configs/android/kunit_clk_defconfig
```kconfig
# Only for architectures that set CONFIG_COMMON_CLK
CONFIG_CLK_KUNIT_TEST=m
CONFIG_CLK_GATE_KUNIT_TEST=m
```

## tools/testing/kunit/configs/android/kunit_defconfig
```kconfig
# Defconfig fragment for Android Kunit targets
#
# Instead of setting CONFIG_KUNIT_ALL_TESTS=m, we enable individual tests
# because:
# - The defconfig fragment is applied after make defconfig
# - If additional tests are added to CONFIG_KUNIT_ALL_TESTS in the future,
#   //common:kunit_* module_outs needs to be updated.

# CONFIG_MODULE_SIG_ALL is not set

# Corresponds to BUILD.bazel, _KUNIT_COMMON_MODULES
CONFIG_TIME_KUNIT_TEST=m
CONFIG_NETDEV_ADDR_LIST_TEST=m
CONFIG_REGMAP_KUNIT=m
CONFIG_INPUT_KUNIT_TEST=m
CONFIG_SND_SOC_TOPOLOGY_KUNIT_TEST=m
CONFIG_SND_SOC_UTILS_KUNIT_TEST=m
CONFIG_HID_KUNIT_TEST=m
CONFIG_RTC_LIB_KUNIT_TEST=m
CONFIG_IIO_FORMAT_KUNIT_TEST=m
CONFIG_EXT4_KUNIT_TESTS=m
CONFIG_FAT_KUNIT_TEST=m
CONFIG_KFENCE_KUNIT_TEST=m
CONFIG_KUNIT_TEST=m
CONFIG_KUNIT_EXAMPLE_TEST=m

# CONFIG_NET_HANDSHAKE is not enabled in gki_defconfig.
# CONFIG_NET_HANDSHAKE_KUNIT_TEST=m

# TODO(b/296116800): Enable these tests
# CONFIG_DRM_KUNIT_TEST=m
# CONFIG_KASAN_KUNIT_TEST=m

# TODO(b/296116800): These are booleans, not tristates.
# CONFIG_BINFMT_ELF_KUNIT_TEST=y
# CONFIG_PM_QOS_KUNIT_TEST=y
# CONFIG_DRIVER_PE_KUNIT_TEST=y
```
