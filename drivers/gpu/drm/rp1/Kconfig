## drivers/gpu/drm/rp1/Kconfig
```kconfig
source "drivers/gpu/drm/rp1/rp1-dsi/Kconfig"

source "drivers/gpu/drm/rp1/rp1-dpi/Kconfig"

source "drivers/gpu/drm/rp1/rp1-vec/Kconfig"
```

## drivers/gpu/drm/rp1/rp1-dpi/Kconfig
```kconfig
# SPDX-License-Identifier: GPL-2.0-only
config DRM_RP1_DPI
	tristate "DRM Support for RP1 DPI"
	depends on DRM && MFD_RP1
	select DRM_GEM_DMA_HELPER
	select DRM_KMS_HELPER
	select DRM_VRAM_HELPER
	select DRM_TTM
	select DRM_TTM_HELPER
	depends on RP1_PIO || !RP1_PIO
	help
	  Choose this option to enable DPI output on Raspberry Pi RP1

	  There is an optional dependency on RP1_PIO, as the PIO block
	  must be used to fix up interlaced sync. Interlaced DPI modes
	  will be unavailable when RP1_PIO is not selected.
```

## drivers/gpu/drm/rp1/rp1-dsi/Kconfig
```kconfig
# SPDX-License-Identifier: GPL-2.0-only
config DRM_RP1_DSI
	tristate "DRM Support for RP1 DSI"
	depends on DRM && MFD_RP1
	select DRM_CLIENT_SELECTION
	select DRM_GEM_DMA_HELPER
	select DRM_KMS_HELPER
	select DRM_MIPI_DSI
	select GENERIC_PHY
	select GENERIC_PHY_MIPI_DPHY
	help
	  Choose this option to enable DSI display on RP1
```

## drivers/gpu/drm/vc4/Kconfig
```kconfig
config DRM_VC4
	tristate "Broadcom VC4 Graphics"
	depends on ARCH_BCM2835 || ARCH_BCM2708 || ARCH_BCM2709 || COMPILE_TEST
	depends on DRM && HAVE_DMA_ATTRS
	select DRM_KMS_HELPER
	select DRM_KMS_CMA_HELPER
	select DRM_GEM_CMA_HELPER
	select DRM_PANEL
	select DRM_MIPI_DSI
	select CLKSRC_OF
	help
	  Choose this option if you have a system that has a Broadcom
	  VC4 GPU, such as the Raspberry Pi or other BCM2708/BCM2835.

	  This driver requires that "avoid_warnings=2" be present in
	  the config.txt for the firmware, to keep it from smashing
	  our display setup.
```

## drivers/media/dvb-frontends/cxd2880/Kconfig
```kconfig
config DVB_CXD2880
	tristate "Sony CXD2880 DVB-T2/T tuner + demodulator"
	depends on DVB_CORE && SPI
	default m if !MEDIA_SUBDRV_AUTOSELECT
	help
	  Say Y when you want to support this frontend.
```

## drivers/media/pci/hailo/Kconfig
```kconfig
config MEDIA_PCI_HAILO
	tristate "Hailo AI accelerator PCIe driver"
	depends on PCI
	help
	  Enable build of Hailo AI accelerator PCIe driver.
```

## drivers/media/platform/bcm2835/Kconfig
```kconfig
# Broadcom VideoCore4 V4L2 camera support

config VIDEO_BCM2835_UNICAM_LEGACY
	tristate "Broadcom BCM283x/BCM271x Unicam video capture driver - no MC"
	depends on VIDEO_DEV
	depends on ARCH_BCM2835 || COMPILE_TEST
	select VIDEO_V4L2_SUBDEV_API
	select MEDIA_CONTROLLER
	select VIDEOBUF2_DMA_CONTIG
	select V4L2_FWNODE
	help
	  Say Y here to enable support for the BCM283x/BCM271x CSI-2 receiver.
	  This is a V4L2 driver that controls the CSI-2 receiver directly,
	  independently from the VC4 firmware.
	  This is the downstream version of this driver that still supports
	  being driven from the video node for simple devices. The mainline
	  driver only supports using Media Controller.
	  This driver is mutually exclusive with the use of bcm2835-camera. The
	  firmware will disable all access to the peripheral from within the
	  firmware if it finds a DT node using it, and bcm2835-camera will
	  therefore fail to probe.

	  To compile this driver as a module, choose M here. The module will be
	  called bcm2835-unicam.
```

## drivers/media/platform/raspberrypi/hevc_dec/Kconfig
```kconfig
# SPDX-License-Identifier: GPL-2.0

config VIDEO_RPI_HEVC_DEC
	tristate "Rasperry Pi HEVC decoder"
	depends on VIDEO_DEV && VIDEO_DEV
	depends on OF
	select MEDIA_CONTROLLER
	select MEDIA_CONTROLLER_REQUEST_API
	select VIDEOBUF2_DMA_CONTIG
	select V4L2_MEM2MEM_DEV
	help
	  Support for the Raspberry Pi HEVC / H265 H/W decoder as a stateless
	  V4L2 decoder device.

	  To compile this driver as a module, choose M here: the module
	  will be called rpi-hevc-dec.
```

## drivers/media/platform/raspberrypi/pisp_be/Kconfig
```kconfig
config VIDEO_RASPBERRYPI_PISP_BE
	tristate "Raspberry Pi PiSP Backend (BE) ISP driver"
	depends on VIDEO_DEV && PM
	select VIDEO_V4L2_SUBDEV_API
	select MEDIA_CONTROLLER
	select VIDEOBUF2_DMA_CONTIG
	select V4L2_FWNODE
	help
	  Say Y here to enable support for the PiSP Backend (BE) ISP driver.

	  To compile this driver as a module, choose M here. The module will be
	  called pisp-be.
```

## drivers/media/platform/raspberrypi/rp1_cfe/Kconfig
```kconfig
# RP1 V4L2 camera support

config VIDEO_RP1_CFE_DOWNSTREAM
	tristate "RP1 DOWNSTREAM Camera Frond End (CFE) video capture driver"
	depends on VIDEO_DEV
	select VIDEO_V4L2_SUBDEV_API
	select MEDIA_CONTROLLER
	select VIDEOBUF2_DMA_CONTIG
	select V4L2_FWNODE
	help
	  Say Y here to enable support for the RP1 Camera Front End using
	  the downstream driver.

	  To compile this driver as a module, choose M here. The module will be
	  called rp1-cfe-downstream.
```

## drivers/misc/vc04_services/Kconfig
```kconfig
config BCM2708_VCHIQ
	tristate "Videocore VCHIQ"
	depends on (MACH_BCM2708 || MACH_BCM2709 || ARCH_BCM2835) && BCM2708_MBOX
	default y
	help
		Kernel to VideoCore communication interface for the
		BCM2708 family of products.
		Defaults to Y when the Broadcom Videocore services
		are included in the build, N otherwise.
```

## drivers/net/wireless/realtek/rtl8192cu/Kconfig
```kconfig
config RTL8192CU
	tristate "Realtek 8192C USB WiFi"
	depends on MAC80211 && USB
	select CFG80211_WEXT
	select WIRELESS_EXT
	select WEXT_PRIV
	---help---
	  This option adds the Realtek RTL8192CU USB device such as Edimax EW-7811Un.
```

## drivers/net/wireless/rtl8192cu/Kconfig
```kconfig
config RTL8192CU
	tristate "Realtek 8192C USB WiFi"
	depends on MAC80211 && USB
	select CFG80211_WEXT
	select WIRELESS_EXT
	select WEXT_PRIV
	---help---
	  This option adds the Realtek RTL8192CU USB device such as Edimax EW-7811Un.

if RTL8192CU

config AP_MODE
	bool "Realtek RTL8192CU AP mode"
	default y
	---help---
	This option enables Access Point mode.

endif
```

## drivers/net/wwan/Kconfig
```kconfig
# SPDX-License-Identifier: GPL-2.0-only
#
# Wireless WAN device configuration
#

menu "Wireless WAN"

config WWAN
	tristate "WWAN Driver Core"
	help
	  Say Y here if you want to use the WWAN driver core. This driver
	  provides a common framework for WWAN drivers.

	  To compile this driver as a module, choose M here: the module will be
	  called wwan.

if WWAN

config MHI_WWAN_CTRL
	tristate "MHI WWAN control driver for QCOM-based PCIe modems"
	depends on MHI_BUS
	help
	  MHI WWAN CTRL allows QCOM-based PCIe modems to expose different modem
	  control protocols/ports to userspace, including AT, MBIM, QMI, DIAG
	  and FIREHOSE. These protocols can be accessed directly from userspace
	  (e.g. AT commands) or via libraries/tools (e.g. libmbim, libqmi,
	  libqcdm...).

	  To compile this driver as a module, choose M here: the module will be
	  called mhi_wwan_ctrl.

endif # WWAN

endmenu
```

## drivers/perf/Kconfig
```kconfig
#
# Performance Monitor Drivers
#

menu "Performance monitor support"

config ARM_PMU
	depends on PERF_EVENTS && (ARM || ARM64)
	bool "ARM PMU framework"
	default y
	help
	  Say y if you want to use CPU performance monitors on ARM-based
	  systems.

config XGENE_PMU
        depends on PERF_EVENTS && ARCH_XGENE
        bool "APM X-Gene SoC PMU"
        default n
        help
          Say y if you want to use APM X-Gene SoC performance monitors.

config RPI_AXIPERF
        depends on ARCH_BCM2835
        tristate "RaspberryPi AXI Performance monitors"
        default n
        help
          Say y if you want to use Raspberry Pi AXI performance monitors, m if
          you want to build it as a module.
endmenu
```

## drivers/soc/bcm2835/Kconfig
```kconfig
#
# BCM2835 Soc drivers
#
config BCM2708_POWER
        tristate "BCM2708 legacy power driver"
        depends on (ARCH_BCM2708 || ARCH_BCM2709 || ARCH_BCM2835) && BCM2708_MBOX
        default y
        help
          Turns on USB power and provides an API for controlling power.
```

## drivers/staging/media/rpivid/Kconfig
```kconfig
# SPDX-License-Identifier: GPL-2.0

config VIDEO_RPIVID
	tristate "Rpi H265 driver"
	depends on VIDEO_DEV && VIDEO_V4L2
	depends on OF
	select MEDIA_CONTROLLER
	select MEDIA_CONTROLLER_REQUEST_API
	select VIDEOBUF2_DMA_CONTIG
	select V4L2_MEM2MEM_DEV
	help
	  Support for the Rpi H265 h/w decoder.

	  To compile this driver as a module, choose M here: the module
	  will be called rpivid-hevc.
```

## drivers/staging/vc04_services/bcm2835-codec/Kconfig
```kconfig
config VIDEO_CODEC_BCM2835
	tristate "BCM2835 Video codec support"
	depends on MEDIA_SUPPORT
	depends on VIDEO_V4L2 && (ARCH_BCM2835 || COMPILE_TEST)
	select BCM2835_VCHIQ_MMAL
	select VIDEOBUF2_DMA_CONTIG
	select V4L2_MEM2MEM_DEV
	help
	  Say Y here to enable the V4L2 video codecs for
	  Broadcom BCM2835 SoC. This operates over the VCHIQ interface
	  to a service running on VideoCore.
```

## drivers/staging/vc04_services/bcm2835-isp/Kconfig
```kconfig
config VIDEO_ISP_BCM2835
	tristate "BCM2835 ISP support"
	depends on MEDIA_SUPPORT
	depends on VIDEO_DEV && (ARCH_BCM2835 || COMPILE_TEST)
	depends on MEDIA_CONTROLLER
	select BCM2835_VCHIQ_MMAL
	select VIDEOBUF2_DMA_CONTIG
	help
	  This is the V4L2 driver for the Broadcom BCM2835 ISP hardware.
	  This operates over the VCHIQ interface to a service running on
	  VideoCore.

	  To compile this driver as a module, choose M here: the module
	  will be called bcm2835-isp.
```

## drivers/staging/vc04_services/vc-sm-cma/Kconfig
```kconfig
config BCM_VC_SM_CMA
	bool "VideoCore Shared Memory (CMA) driver"
	depends on BCM2835_VCHIQ && DMA_CMA
	select RBTREE
	select DMA_SHARED_BUFFER
	help
	  Say Y here to enable the shared memory interface that
	  supports sharing dmabufs with VideoCore.
	  This operates over the VCHIQ interface to a service
	  running on VideoCore.
```

## drivers/staging/vc04_services/vchiq-mmal/Kconfig
```kconfig
config BCM2835_VCHIQ_MMAL
	tristate "BCM2835 MMAL VCHIQ service"
	depends on (ARCH_BCM2835 || COMPILE_TEST)
	select BCM2835_VCHIQ
	select BCM_VC_SM_CMA
	help
	  Enables the MMAL API over VCHIQ as used for the
	  majority of the multimedia services on VideoCore.
```

## drivers/tty/serial/pkvm-pl011/Kconfig
```kconfig
# SPDX-License-Identifier: GPL-2.0

config SERIAL_PKVM_PL011
	tristate "Protected KVM PL011 UART"
	depends on ARM64
	depends on KVM

config SERIAL_PKVM_PL011_BASE_PHYS
	hex
	depends on SERIAL_PKVM_PL011
	default 0x09000000

config SERIAL_PKVM_PL011_UARTFR
	hex
	depends on SERIAL_PKVM_PL011
	default 0x18

config SERIAL_PKVM_PL011_UARTTX
	hex
	depends on SERIAL_PKVM_PL011
	default 0x0

config SERIAL_PKVM_PL011_BUSY
	hex
	depends on SERIAL_PKVM_PL011
	default 0x2

config SERIAL_PKVM_PL011_FULL
	hex
	depends on SERIAL_PKVM_PL011
	default 0x6
```

## fs/incfs/Kconfig
```kconfig
config INCREMENTAL_FS
	tristate "Incremental file system support"
	depends on BLOCK
	# incfs does not verify fsverity builtin signatures.
	depends on !CONFIG_FS_VERITY_BUILTIN_SIGNATURES
	select DECOMPRESS_LZ4
	select DECOMPRESS_ZSTD
	select CRYPTO_SHA256
	help
	  Incremental FS is a read-only virtual file system that facilitates execution
	  of programs while their binaries are still being lazily downloaded over the
	  network, USB or pigeon post.

	  To compile this file system support as a module, choose M here: the
	  module will be called incrementalfs.
```

## kernel/Kconfig.preempt
```kconfig
config PREEMPT
	bool
	select PREEMPT_COUNT

config PREEMPT_RT_BASE
	bool
	select PREEMPT

config HAVE_PREEMPT_LAZY
	bool

config PREEMPT_LAZY
	def_bool y if HAVE_PREEMPT_LAZY && PREEMPT_RT_FULL

choice
	prompt "Preemption Model"
	default PREEMPT_NONE

config PREEMPT_NONE
	bool "No Forced Preemption (Server)"
	help
	  This is the traditional Linux preemption model, geared towards
	  throughput. It will still provide good latencies most of the
	  time, but there are no guarantees and occasional longer delays
	  are possible.

	  Select this option if you are building a kernel for a server or
	  scientific/computation system, or if you want to maximize the
	  raw processing power of the kernel, irrespective of scheduling
	  latencies.

config PREEMPT_VOLUNTARY
	bool "Voluntary Kernel Preemption (Desktop)"
	depends on !ARCH_NO_PREEMPT
	help
	  This option reduces the latency of the kernel by adding more
	  "explicit preemption points" to the kernel code. These new
	  preemption points have been selected to reduce the maximum
	  latency of rescheduling, providing faster application reactions,
	  at the cost of slightly lower throughput.

	  This allows reaction to interactive events by allowing a
	  low priority process to voluntarily preempt itself even if it
	  is in kernel mode executing a system call. This allows
	  applications to run more 'smoothly' even when the system is
	  under load.

	  Select this if you are building a kernel for a desktop system.

config PREEMPT__LL
	bool "Preemptible Kernel (Low-Latency Desktop)"
	depends on !ARCH_NO_PREEMPT
	select PREEMPT
	select UNINLINE_SPIN_UNLOCK if !ARCH_INLINE_SPIN_UNLOCK
	help
	  This option reduces the latency of the kernel by making
	  all kernel code (that is not executing in a critical section)
	  preemptible.  This allows reaction to interactive events by
	  permitting a low priority process to be preempted involuntarily
	  even if it is in kernel mode executing a system call and would
	  otherwise not be about to reach a natural preemption point.
	  This allows applications to run more 'smoothly' even when the
	  system is under load, at the cost of slightly lower throughput
	  and a slight runtime overhead to kernel code.

	  Select this if you are building a kernel for a desktop or
	  embedded system with latency requirements in the milliseconds
	  range.

config PREEMPT_RTB
	bool "Preemptible Kernel (Basic RT)"
	select PREEMPT_RT_BASE
	help
	  This option is basically the same as (Low-Latency Desktop) but
	  enables changes which are preliminary for the full preemptible
	  RT kernel.

config PREEMPT_RT_FULL
	bool "Fully Preemptible Kernel (RT)"
	depends on IRQ_FORCED_THREADING
	select PREEMPT_RT_BASE
	select PREEMPT_RCU
	help
	  All and everything

endchoice

config PREEMPT_COUNT
       bool
```
