#include "bcm2708.dtsi"
#include "bcm2708-rpi.dtsi"

&leds {
	act_led: led-act {
		label = "led0";
		linux,default-trigger = "mmc0";
		gpios = <&gpio 47 0>;
	};
};

/ {
	__overrides__ {
		act_led_gpio = <&act_led>,"gpios:4";
		act_led_activelow = <&act_led>,"gpios:8";
		act_led_trigger = <&act_led>,"linux,default-trigger";
		cam0_reg = <&cam0_reg>,"status";
		cam0_reg_gpio = <&cam0_reg>,"gpios:4";
		cam1_reg = <&cam1_reg>,"status";
		cam1_reg_gpio = <&cam1_reg>,"gpios:4";
	};
};
