#include "bcm2835.dtsi"

&leds {
	act_led: act {
		label = "led0";
		linux,default-trigger = "mmc0";
		gpios = <&gpio 47 0>;
	};
};

&sdhost {
	pinctrl-names = "default";
	pinctrl-0 = <&sdhost_pins>;
	bus-width = <4>;
	non-removable;
	status = "okay";
};

&fb {
	status = "okay";
};

/ {
	__overrides__ {
		act_led_gpio = <&act_led>,"gpios:4";
		act_led_activelow = <&act_led>,"gpios:8";
		act_led_trigger = <&act_led>,"linux,default-trigger";

		audio = <&audio>,"status";
		watchdog = <&watchdog>,"status";
		random = <&random>,"status";
	};
};
