// Definitions for PCF2127 Real Time Clock
/dts-v1/;
/plugin/;

/ {
	compatible = "brcm,bcm2708";

	fragment@0 {
		target = <&i2c1>;
		__overlay__ {
			#address-cells = <1>;
			#size-cells = <0>;
			status = "okay";

			pcf2127@51 {
				compatible = "nxp,pcf2127";
				reg = <0x51>;
				status = "okay";
			};
		};
	};
};
