// SPDX-License-Identifier: GPL-2.0
/dts-v1/;

#include "bcm2712-rpi-cm5.dtsi"

i2c_csi_dsi: &i2c_csi_dsi0 { }; // An alias for compatibility

/ {
	__overrides__ {
		i2c_csi_dsi = <&i2c_csi_dsi>, "status";
	};
};
