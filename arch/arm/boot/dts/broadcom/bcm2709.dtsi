#define i2c0 i2c0if
#include "bcm2836.dtsi"
#undef i2c0
#include "bcm270x.dtsi"

/ {
	soc {
		ranges = <0x7e000000 0x3f000000 0x01000000>,
		         <0x40000000 0x40000000 0x00040000>;

		dma-ranges = <0xc0000000 0x00000000 0x3f000000>,
			     <0x7e000000 0x3f000000 0x01000000>;
	};

	__overrides__ {
		arm_freq = <&v7_cpu0>, "clock-frequency:0",
			   <&v7_cpu1>, "clock-frequency:0",
			   <&v7_cpu2>, "clock-frequency:0",
			   <&v7_cpu3>, "clock-frequency:0";
	};
};

&system_timer {
	status = "disabled";
};

&vc4 {
	status = "disabled";
};
