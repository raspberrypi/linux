#include "bcm2836.dtsi"
#include "bcm270x.dtsi"
#include "bcm2709-rpi.dtsi"

/ {
	soc {
		ranges = <0x7e000000 0x3f000000 0x01000000>,
		         <0x40000000 0x40000000 0x00040000>;

		/delete-node/ timer@7e003000;
	};

	__overrides__ {
		arm_freq = <&v7_cpu0>, "clock-frequency:0",
			   <&v7_cpu1>, "clock-frequency:0",
			   <&v7_cpu2>, "clock-frequency:0",
			   <&v7_cpu3>, "clock-frequency:0";
	};
};
