// Definitions for NXP PCA9685A I2C PWM controller on ARM I2C bus.
/dts-v1/;
/plugin/;

/{
	compatible = "brcm,bcm2835";

	fragment@0 {
		target = <&i2cbus>;
		__overlay__ {
			#address-cells = <1>;
			#size-cells = <0>;
			status = "okay";

			pca: pca@40 {
				compatible = "nxp,pca9685-pwm";
				#pwm-cells = <2>;
				reg = <0x40>;
				status = "okay";
			};
		};
	};


	frag100: fragment@100 {
		target = <&i2c_arm>;
		i2cbus: __overlay__ {
			status = "okay";
		};
	};

	fragment@101 {
		target = <&i2c0if>;
		__dormant__ {
			status = "okay";
		};
	};

	fragment@102 {
		target = <&i2c0mux>;
		__dormant__ {
			status = "okay";
		};
	};

	__overrides__ {
		addr = <&pca>,"reg:0";
		i2c0 = <&frag100>, "target:0=",<&i2c0>,
			      <0>,"+101+102";
		i2c_csi_dsi = <&frag100>, "target:0=",<&i2c_csi_dsi>,
			      <0>,"+101+102";
		i2c_csi_dsi0 = <&frag100>, "target:0=",<&i2c_csi_dsi0>,
			      <0>,"+101+102";
		i2c3 = <&frag100>, "target?=0",
		       <&frag100>, "target-path=i2c3";
		i2c4 = <&frag100>, "target?=0",
		       <&frag100>, "target-path=i2c4";
		i2c5 = <&frag100>, "target?=0",
		       <&frag100>, "target-path=i2c5";
		i2c6 = <&frag100>, "target?=0",
		       <&frag100>, "target-path=i2c6";
		i2c-path = <&frag100>, "target?=0",
			   <&frag100>, "target-path";
	};
};
