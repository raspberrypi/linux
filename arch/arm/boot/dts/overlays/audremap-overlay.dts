/dts-v1/;
/plugin/;

/ {
        compatible = "brcm,bcm2835";

        fragment@0 {
                target = <&audio_pins>;
                frag0: __overlay__ {
                };
        };

	fragment@1 {
                target = <&audio_pins>;
                __overlay__ {
                        brcm,pins = < 12 13 >;
                        brcm,function = < 4 >; /* alt0 alt0 */
                        brcm,pull = < 0 >;
                };
        };

	fragment@2 {
		target = <&audio_pins>;
		__dormant__ {
                        brcm,pins = < 18 19 >;
                        brcm,function = < 2 >; /* alt5 alt5 */
                        brcm,pull = < 0 >;
		};
	};

	fragment@3 {
		target = <&chosen>;
		__overlay__  {
			bootargs = "snd_bcm2835.enable_headphones=1";
		};
	};

	__overrides__ {
		swap_lr = <&frag0>, "swap_lr?";
		enable_jack = <&frag0>, "enable_jack?";
		pins_12_13 = <0>,"+1-2";
		pins_18_19 = <0>,"-1+2";
	};
};
