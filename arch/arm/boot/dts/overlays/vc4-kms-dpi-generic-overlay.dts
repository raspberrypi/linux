/*
 * vc4-kms-dpi-generic-overlay.dts
 */

/dts-v1/;
/plugin/;

#include "vc4-kms-dpi.dtsi"

/ {
	compatible = "brcm,bcm2835";

	fragment@0 {
		target = <&panel>;
		panel_generic: __overlay__  {
			compatible = "panel-dpi";

			width-mm = <154>;
			height-mm = <83>;
			bus-format = <0x1009>;

			timing: panel-timing {
				clock-frequency = <29500000>;
				hactive = <800>;
				hfront-porch = <24>;
				hsync-len = <72>;
				hback-porch = <96>;
				hsync-active = <1>;
				vactive = <480>;
				vfront-porch = <3>;
				vsync-len = <10>;
				vback-porch = <7>;
				vsync-active = <1>;

				de-active = <1>;
				pixelclk-active = <1>;
			};
		};
	};

	fragment@1 {
		target = <&dpi>;
		dpi_node_generic: __overlay__  {
			pinctrl-0 = <&dpi_18bit_gpio0>;
		};
	};

	__overrides__ {
		clock-frequency = <&timing>, "clock-frequency:0";
		hactive = <&timing>, "hactive:0";
		hfp = <&timing>, "hfront-porch:0";
		hsync = <&timing>, "hsync-len:0";
		hbp = <&timing>, "hback-porch:0";
		vactive = <&timing>, "vactive:0";
		vfp = <&timing>, "vfront-porch:0";
		vsync = <&timing>, "vsync-len:0";
		vbp = <&timing>, "vback-porch:0";
		hsync-invert = <&timing>, "hsync-active:0=0";
		vsync-invert = <&timing>, "vsync-active:0=0";
		de-invert = <&timing>, "de-active:0=0";
		pixclk-invert = <&timing>, "pixelclk-active:0=0";
		interlaced = <&timing>, "interlaced?";

		width-mm = <&panel_generic>, "width-mm:0";
		height-mm = <&panel_generic>, "height-mm:0";

		rgb565 = <&panel_generic>, "bus-format:0=0x1017",
			<&dpi_node_generic>, "pinctrl-0:0=",<&dpi_16bit_gpio0>;
		rgb565-padhi = <&panel_generic>, "bus-format:0=0x1022",
			<&dpi_node_generic>, "pinctrl-0:0=",<&dpi_16bit_cpadhi_gpio0>;
		bgr666 = <&panel_generic>, "bus-format:0=0x1023";
		bgr666-padhi = <&panel_generic>, "bus-format:0=0x1024",
			<&dpi_node_generic>, "pinctrl-0:0=",<&dpi_18bit_cpadhi_gpio0>;
		rgb666-padhi = <&panel_generic>, "bus-format:0=0x1015",
			<&dpi_node_generic>, "pinctrl-0:0=",<&dpi_18bit_cpadhi_gpio0>;
		bgr888 = <&panel_generic>, "bus-format:0=0x1013",
			<&dpi_node_generic>, "pinctrl-0:0=",<&dpi_gpio0>;
		rgb888 = <&panel_generic>, "bus-format:0=0x100a",
			<&dpi_node_generic>, "pinctrl-0:0=",<&dpi_gpio0>;
		bus-format = <&panel_generic>, "bus-format:0";
		rgb-order = <&dpi_node_generic>, "rgb_order";
	};
};
