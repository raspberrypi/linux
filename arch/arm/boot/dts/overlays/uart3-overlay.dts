/dts-v1/;
/plugin/;

/{
	compatible = "brcm,bcm2711";

	fragment@0 {
		target = <&uart3>;
		__overlay__ {
			pinctrl-names = "default";
			pinctrl-0 = <&uart3_pins>;
			status = "okay";
		};
	};

	fragment@1 {
		target = <&uart3_pins>;
		__dormant__ {
			brcm,pins = <4 5 6 7>;
			brcm,pull = <0 2 2 0>;
		};
	};

	__overrides__ {
		ctsrts = <0>,"=1";
	};
};
