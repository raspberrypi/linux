/dts-v1/;
/plugin/;

/{
	compatible = "brcm,bcm2711";

	fragment@0 {
		target = <&uart4>;
		__overlay__ {
			status = "okay";
		};
	};

	fragment@1 {
		target = <&uart4_pins>;
		__dormant__ {
			brcm,pins = <8 9 10 11>;
			brcm,pull = <0 2 2 0>;
		};
	};

	__overrides__ {
		ctsrts = <0>,"=1";
	};
};
