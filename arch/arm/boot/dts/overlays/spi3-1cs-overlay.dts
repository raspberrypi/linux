/dts-v1/;
/plugin/;


/ {
	compatible = "brcm,bcm2711";

	fragment@0 {
		target = <&spi3_cs_pins>;
		frag0: __overlay__ {
			brcm,pins = <0>;
			brcm,function = <1>; /* output */
		};
	};

	fragment@1 {
		target = <&spi3>;
		frag1: __overlay__ {
			/* needed to avoid dtc warning */
			#address-cells = <1>;
			#size-cells = <0>;

			cs-gpios = <&gpio 0 1>;
			status = "okay";

			spidev3_0: spidev@0 {
				compatible = "spidev";
				reg = <0>;      /* CE0 */
				#address-cells = <1>;
				#size-cells = <0>;
				spi-max-frequency = <125000000>;
				status = "okay";
			};
		};
	};

	__overrides__ {
		cs0_pin  = <&frag0>,"brcm,pins:0",
			   <&frag1>,"cs-gpios:4";
		cs0_spidev = <&spidev3_0>,"status";
	};
};
