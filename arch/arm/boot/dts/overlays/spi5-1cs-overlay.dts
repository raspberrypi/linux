/dts-v1/;
/plugin/;


/ {
	compatible = "brcm,bcm2838";

	fragment@0 {
		target = <&spi5_cs_pins>;
		frag0: __overlay__ {
			brcm,pins = <12>;
			brcm,function = <1>; /* output */
		};
	};

	fragment@1 {
		target = <&spi5>;
		frag1: __overlay__ {
			/* needed to avoid dtc warning */
			#address-cells = <1>;
			#size-cells = <0>;

			pinctrl-names = "default";
		        pinctrl-0 = <&spi5_pins &spi5_cs_pins>;
			cs-gpios = <&gpio 12 1>;
			status = "okay";

			spidev5_0: spidev@0 {
				compatible = "spidev";
				reg = <0>;      /* CE0 */
				#address-cells = <1>;
				#size-cells = <0>;
				spi-max-frequency = <125000000>;
				status = "okay";
			};
		};
	};

	__overrides__ {
		cs0_pin  = <&frag0>,"brcm,pins:0",
			   <&frag1>,"cs-gpios:4";
		cs0_spidev = <&spidev5_0>,"status";
	};
};
