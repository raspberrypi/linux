/dts-v1/;
/plugin/;

/{
	compatible = "brcm,bcm2835";

	fragment@0 {
		target = <&i2c1>;
		__overlay__ {
			status = "okay";
			pinctrl-names = "default";
			pinctrl-0 = <&i2c1_pins>;
		};
	};

	fragment@1 {
		target = <&i2c1_pins>;
		pins1: __overlay__ {
			brcm,pins = <2 3>;
			brcm,function = <4>; /* alt 0 */
		};
	};

	fragment@2 {
		target = <&i2c1_pins>;
		pins2: __dormant__ {
			brcm,pins = <44 45>;
			brcm,function = <6>; /* alt 2 */
		};
	};

	fragment@3 {
		target = <&i2c1>;
		__dormant__ {
			compatible = "brcm,bcm2708-i2c";
		};
	};

	__overrides__ {
		pins_2_3   = <0>,"=1!2";
		pins_44_45 = <0>,"!1=2";
		combine = <0>, "!3";
	};
};
