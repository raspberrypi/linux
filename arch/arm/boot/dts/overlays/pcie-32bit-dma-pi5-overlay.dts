/*
 * pcie-32bit-dma-pi5-overlay.dts
 */

/dts-v1/;
/plugin/;

/ {
	compatible = "brcm,bcm2712";

	fragment@0 {
		target = <&pcie1>;
		__overlay__ {
			/*
			 * The size of the range is rounded up to a power of 2,
			 * so the range ends up being 0-4GB, and the MSI vector
			 * gets pushed beyond 4GB.
			 */
			#address-cells = <3>;
			#size-cells = <2>;
			dma-ranges = <0x02000000 0x0 0x00000000 0x0 0x00000000
				      0x0 0x80000000>,
				     <0x02000000 0x00 0xfffff000 0x10 0x00131000
				      0x00 0x00001000>;
		};
	};

	fragment@1 {
		target = <&mip1>;
		__overlay__ {
			/*
			 * The MIP driver uses the reg property to derive the target
			 * address for MSI writes - place this below 4GB.
			 */
			reg = <0x10 0x00131000 0x00 0xc0>,
			      <0x00 0xfffff000 0x00 0x1000>;
		};
	};
};
