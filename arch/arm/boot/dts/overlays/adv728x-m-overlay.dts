// SPDX-License-Identifier: GPL-2.0-only
// Definitions for Analog Devices ADV728[0|1|2]-M video to CSI2 bridges on VC
// I2C bus

#include "adv7282m-overlay.dts"

/{
	compatible = "brcm,bcm2708";

	// Fragment numbers deliberately high to avoid conflicts with the
	// included adv7282m overlay file.

	fragment@101 {
		target = <&adv728x>;
		__dormant__ {
			compatible = "adi,adv7280-m";
		};
	};
	fragment@102 {
		target = <&adv728x>;
		__dormant__ {
			compatible = "adi,adv7281-m";
		};
	};
	fragment@103 {
		target = <&adv728x>;
		__dormant__ {
			compatible = "adi,adv7281-ma";
		};
	};

	__overrides__ {
		adv7280m = <0>, "+101";
		adv7281m = <0>, "+102";
		adv7281ma = <0>, "+103";
	};
};
