/dts-v1/;
/plugin/;

/{
	compatible = "brcm,bcm2838";

	fragment@0 {
		target = <&i2c5>;
		frag0: __overlay__ {
			status = "okay";
			pinctrl-names = "default";
			pinctrl-0 = <&i2c5_pins>;
			clock-frequency = <100000>;
		};
	};

	fragment@1 {
		target = <&i2c5_pins>;
		__dormant__ {
			brcm,pins = <10 11>;
		};
	};

	fragment@2 {
		target = <&i2c5_pins>;
		__overlay__ {
			brcm,pins = <12 13>;
		};
	};

	__overrides__ {
		pins_10_11 = <0>,"=1!2";
		pins_12_13 = <0>,"!1=2";
		baudrate = <&frag0>, "clock-frequency:0";
	};
};
