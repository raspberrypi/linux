// Definitions for I2C based sensors used in Android
/dts-v1/;
/plugin/;

/ {
    compatible = "brcm,bcm2835";

    fragment@0 {
        target = <&i2c_arm>;
        __dormant__ {
            #address-cells = <1>;
            #size-cells = <0>;
            status = "okay";

            lsm6ds3: lsm6ds3@6b {
                compatible = "st,lsm6ds3";
                reg = <0x6b>;
                interrupt-parent = <&gpio>;
                interrupts = <4 1>;
                status = "okay";
            };
        };
    };

    fragment@1 {
        target = <&i2c_arm>;
        __dormant__ {
            #address-cells = <1>;
            #size-cells = <0>;
            status = "okay";
            clock-frequency = <400000>;

            mpu6050: mpu6050@68 {
                compatible = "invensense,mpu6050";
                reg = <0x68>;
                interrupt-parent = <&gpio>;
                interrupts = <4 1>;
                status = "okay";
            };
        };
    };

    fragment@2 {
        target = <&i2c_arm>;
        __dormant__ {
            #address-cells = <1>;
            #size-cells = <0>;
            status = "okay";

            lsm303dlhca: lsm303dlhca@19 {
                compatible = "st,lsm303dlhc-accel";
                reg = <0x19>;
                status = "okay";
            };
        };
    };

    fragment@3 {
        target = <&i2c_arm>;
        __dormant__ {
            #address-cells = <1>;
            #size-cells = <0>;
            status = "okay";

            lsm303dlhcm: lsm303dlhcm@1e {
                compatible = "st,lsm303dlhc-magn";
                reg = <0x1e>;
                status = "okay";
            };
        };
    };

    fragment@4 {
        target = <&i2c_arm>;
        __dormant__ {
            #address-cells = <1>;
            #size-cells = <0>;
            status = "okay";

            bme280: bme280@76 {
                compatible = "bosch,bme280";
                reg = <0x76>;
                status = "okay";
            };
        };
    };

    fragment@5 {
        target = <&i2c_arm>;
        __dormant__ {
            #address-cells = <1>;
            #size-cells = <0>;
            status = "okay";

            bmp280: bmp280@76 {
                compatible = "bosch,bmp280";
                reg = <0x76>;
                status = "okay";
            };
        };
    };

    fragment@6 {
        target = <&i2c_arm>;
        __dormant__ {
            #address-cells = <1>;
            #size-cells = <0>;
            status = "okay";

            apds9930: apds9930@39 {
                compatible = "avago,apds9930";
                reg = <0x39>;
                status = "okay";
            };
        };
    };

    __overrides__ {
        addr = <&lsm6ds3>,"reg:0", <&mpu6050>,"reg:0", <&lsm303dlhca>,"reg:0", <&lsm303dlhcm>,"reg:0",
                <&bme280>,"reg:0", <&bmp280>,"reg:0", <&apds9930>,"reg:0";
        interrupt = <&lsm6ds3>,"interrupts:0", <&mpu6050>,"interrupts:0";
        lsm6ds3 = <0>,"+0";
        mpu6050 = <0>,"+1";
        lsm303dlhca = <0>,"+2";
        lsm303dlhcm = <0>,"+3";
        bme280 = <0>,"+4";
        bmp280 = <0>,"+5";
        apds9930 = <0>,"+6";
    };
};
