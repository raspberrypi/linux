/dts-v1/;
/plugin/;


/ {
	compatible = "brcm,bcm2712";

	fragment@0 {
		target = <&spi3>;
		frag1: __overlay__ {
			/* needed to avoid dtc warning */
			#address-cells = <1>;
			#size-cells = <0>;

			cs-gpios = <&gpio 4 1>;
			status = "okay";

			spidev3_0: spidev@0 {
				compatible = "spidev";
				reg = <0>;      /* CE0 */
				#address-cells = <1>;
				#size-cells = <0>;
				spi-max-frequency = <125000000>;
				status = "okay";
			};
		};
	};

	__overrides__ {
		cs0_pin  = <&frag1>,"cs-gpios:4";
		cs0_spidev = <&spidev3_0>,"status";
	};
};
