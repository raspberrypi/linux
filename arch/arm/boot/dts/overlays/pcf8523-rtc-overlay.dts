// Definitions for PCF8523 Real Time Clock
/dts-v1/;
/plugin/;

/ {
	compatible = "brcm,bcm2708";

	fragment@0 {
		target = <&i2c1>;
		__overlay__ {
			#address-cells = <1>;
			#size-cells = <0>;
			status = "okay";

			pcf8523@68 {
				compatible = "nxp,pcf8523";
				reg = <0x68>;
				status = "okay";
			};
		};
	};
};
