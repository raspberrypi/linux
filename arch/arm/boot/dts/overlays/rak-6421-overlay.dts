/*
 * Device Tree overlay for RAK 6421 Meshtastic HAT+
 *
 */

/dts-v1/;
/plugin/;

/ {
	compatible = "brcm,bcm2835";


	i2c_frag: fragment@0 {
		target = <&i2c_arm>;
		__overlay__ {
			status = "okay";
		};
	};
	fragment@1 {
		target = <&spi0_cs_pins>;
		frag1: __overlay__ {
			brcm,pins = <8 7>;
		};
	};

	fragment@2 {
		target = <&spi0>;
		frag2: __overlay__ {
			cs-gpios = <&gpio 8 1>, <&gpio 7 1>;
			status = "okay";
		};
	};
};
