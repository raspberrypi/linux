// Definitions for gpio-poweroff module
/dts-v1/;
/plugin/;

/ {
	compatible = "brcm,bcm2835";

	fragment@0 {
		target-path = "/";
		__overlay__ {
			power_ctrl: power_ctrl {
				compatible = "gpio-poweroff";
				gpios = <&gpio 26 0>;
				force;
			};
		};
	};

	__overrides__ {
		gpiopin =       <&power_ctrl>,"gpios:4";
		active_low =    <&power_ctrl>,"gpios:8";
		input =         <&power_ctrl>,"input?";
		export =        <&power_ctrl>,"export?";
		timeout_ms =    <&power_ctrl>,"timeout-ms:0";
		active_delay_ms = <&power_ctrl>,"active-delay-ms:0";
		inactive_delay_ms = <&power_ctrl>,"inactive-delay-ms:0";
	};
};
