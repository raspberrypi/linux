/dts-v1/;
/plugin/;


/ {
	compatible = "brcm,bcm2835";

	fragment@0 {
		target = <&i2c_arm>;
		__dormant__ {
			#address-cells = <1>;
			#size-cells = <0>;
			status = "okay";

			ltc2941: ltc2941@64 {
				compatible = "lltc,ltc2941";
				reg = <0x64>;
				lltc,resistor-sense = <50>;
				lltc,prescaler-exponent = <7>; 
			};
		};
	};

	fragment@1 {
		target = <&i2c_arm>;
		__dormant__ {
			#address-cells = <1>;
			#size-cells = <0>;
			status = "okay";

			ltc2942: ltc2942@64 {
				compatible = "lltc,ltc2942";
				reg = <0x64>;
				lltc,resistor-sense = <50>;
				lltc,prescaler-exponent = <7>; 
			};
		};
	};

	fragment@2 {
		target = <&i2c_arm>;
		__dormant__ {
			#address-cells = <1>;
			#size-cells = <0>;
			status = "okay";

			ltc2943: ltc2943@64 {
				compatible = "lltc,ltc2943";
				reg = <0x64>;
				lltc,resistor-sense = <50>;
				lltc,prescaler-exponent = <7>; 
			};
		};
	};

	fragment@3 {
		target = <&i2c_arm>;
		__dormant__ {
			#address-cells = <1>;
			#size-cells = <0>;
			status = "okay";

			ltc2944: ltc2944@64 {
				compatible = "lltc,ltc2944";
				reg = <0x64>;
				lltc,resistor-sense = <50>;
				lltc,prescaler-exponent = <7>; 
			};
		};
	};

	__overrides__ {
		ltc2941 = <0>,"+0";
		ltc2942 = <0>,"+1";
		ltc2943 = <0>,"+2";
		ltc2944 = <0>,"+3";
		resistor-sense = <&ltc2941>, "lltc,resistor-sense:0",
			         <&ltc2942>, "lltc,resistor-sense:0",
				 <&ltc2943>, "lltc,resistor-sense:0",
				 <&ltc2944>, "lltc,resistor-sense:0";
		prescaler-exponent = <&ltc2941>, "lltc,prescaler-exponent:0",
			         <&ltc2942>, "lltc,prescaler-exponent:0",
				 <&ltc2943>, "lltc,prescaler-exponent:0",
				 <&ltc2944>, "lltc,prescaler-exponent:0";
	};
};
