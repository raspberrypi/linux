// SPDX-License-Identifier: GPL-2.0-only
// Definitions for IMX477 camera module on VC I2C bus
/dts-v1/;
/plugin/;

#include "imx477_378-overlay.dtsi"

&cam_node {
	compatible = "sony,imx477";
};

/{
	__overrides__ {
		sync-sink = <&cam_node>,"trigger-mode:0=2";
		sync-source = <&cam_node>,"trigger-mode:0=1";
	};
};
