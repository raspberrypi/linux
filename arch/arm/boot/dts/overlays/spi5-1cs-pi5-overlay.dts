/dts-v1/;
/plugin/;


/ {
	compatible = "brcm,bcm2712";

	fragment@0 {
		target = <&spi5>;
		frag1: __overlay__ {
			/* needed to avoid dtc warning */
			#address-cells = <1>;
			#size-cells = <0>;

			cs-gpios = <&gpio 12 1>;
			status = "okay";

			spidev5_0: spidev@0 {
				compatible = "spidev";
				reg = <0>;      /* CE0 */
				#address-cells = <1>;
				#size-cells = <0>;
				spi-max-frequency = <125000000>;
				status = "okay";
			};
		};
	};

	__overrides__ {
		cs0_pin  = <&frag1>,"cs-gpios:4";
		cs0_spidev = <&spidev5_0>,"status";
	};
};
