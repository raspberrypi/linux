/dts-v1/;
/plugin/;

/{
	compatible = "brcm,bcm2711";

	fragment@0 {
		target = <&i2c3>;
		frag0: __overlay__ {
			status = "okay";
			clock-frequency = <100000>;
		};
	};

	fragment@1 {
		target = <&i2c3_pins>;
		__dormant__ {
			brcm,pins = <2 3>;
		};
	};

	fragment@2 {
		target = <&i2c3_pins>;
		__overlay__ {
			brcm,pins = <4 5>;
		};
	};

	__overrides__ {
		pins_2_3 = <0>,"=1!2";
		pins_4_5 = <0>,"!1=2";
		baudrate = <&frag0>, "clock-frequency:0";
	};
};
