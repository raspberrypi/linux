/dts-v1/;
/plugin/;

/ {
	compatible = "brcm,bcm2835";

	fragment@0 {
		target-path = "/soc/firmware";
		__overlay__ {
			ts: touchscreen {
				compatible = "raspberrypi,firmware-ts";
				touchscreen-size-x = <800>;
				touchscreen-size-y = <480>;
			};
		};
	};

	__overrides__ {
		touchscreen-size-x = <&ts>,"touchscreen-size-x:0";
		touchscreen-size-y = <&ts>,"touchscreen-size-y:0";
		touchscreen-inverted-x = <&ts>,"touchscreen-inverted-x:?";
		touchscreen-inverted-y = <&ts>,"touchscreen-inverted-y:?";
		touchscreen-swapped-x-y = <&ts>,"touchscreen-swapped-x-y:?";
        };
};
