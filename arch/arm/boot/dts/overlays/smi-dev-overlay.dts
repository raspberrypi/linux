// Description: Overlay to enable character device interface for SMI.
// Author:	Luke Wren <luke@raspberrypi.org>

/dts-v1/;
/plugin/;

/{
	compatible = "brcm,bcm2835";

	fragment@0 {
		target = <&soc>;
		__overlay__ {
			smi_dev {
				compatible = "brcm,bcm2835-smi-dev";
				smi_handle = <&smi>;
				status = "okay";
			};
		};
	};
};
