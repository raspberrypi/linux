/*
 * Device tree overlay to move spi0 to gpio 35 to 39 on CM
 */

/dts-v1/;
/plugin/;

/ {
	compatible = "brcm,bcm2835", "brcm,bcm2836", "brcm,bcm2708", "brcm,bcm2709";

	fragment@0 {
		target = <&spi0>;
		__overlay__ {
			cs-gpios = <&gpio 36 1>, <&gpio 35 1>;
		};
	};

	fragment@1 {
		target = <&spi0_cs_pins>;
		__overlay__ {
			brcm,pins = <36 35>;
		};
	};

	fragment@2 {
		target = <&spi0_pins>;
		__overlay__ {
			brcm,pins = <37 38 39>;
		};
	};
};
