// Definitions for lirc-rpi module
/dts-v1/;
/plugin/;

/ {
	compatible = "brcm,bcm2708";

	fragment@0 {
		target-path = "/";
		__overlay__ {
			lirc_rpi: lirc_rpi {
				compatible = "rpi,lirc-rpi";
				pinctrl-names = "default";
				pinctrl-0 = <&lirc_pins>;
				status = "okay";

				// Override autodetection of IR receiver circuit
				// (0 = active high, 1 = active low, -1 = no override )
				rpi,sense = <0xffffffff>;

				// Software carrier
				// (0 = off, 1 = on)
				rpi,softcarrier = <1>;

				// Invert output
				// (0 = off, 1 = on)
				rpi,invert = <0>;

				// Enable debugging messages
				// (0 = off, 1 = on)
				rpi,debug = <0>;
			};
		};
	};

	fragment@1 {
		target = <&gpio>;
		__overlay__ {
			lirc_pins: lirc_pins {
				brcm,pins = <17 18>;
				brcm,function = <1 0>; // out in
				brcm,pull = <0 1>; // off down
			};
		};
	};

	__overrides__ {
		gpio_out_pin =  <&lirc_pins>,"brcm,pins:0";
		gpio_in_pin =   <&lirc_pins>,"brcm,pins:4";
		gpio_in_pull =  <&lirc_pins>,"brcm,pull:4";

		sense =         <&lirc_rpi>,"rpi,sense:0";
		softcarrier =   <&lirc_rpi>,"rpi,softcarrier:0";
		invert =        <&lirc_rpi>,"rpi,invert:0";
		debug =         <&lirc_rpi>,"rpi,debug:0";
	};
};
