// Overlay for missing AUX interrupt controller
// Instead we bind all AUX devices to the generic AUX interrupt line
/dts-v1/;
/plugin/;

/ {
    compatible = "brcm,bcm2708";

    fragment@0 {
        target = <&uart1>;
        __overlay__ {
            interrupt-parent = <&intc>;
            interrupts = <0x1 0x1d>;
        };
    };

    fragment@1 {
        target = <&spi1>;
        __overlay__ {
            interrupt-parent = <&intc>;
            interrupts = <0x1 0x1d>;
        };
    };

    fragment@2 {
        target = <&spi2>;
        __overlay__ {
            interrupt-parent = <&intc>;
            interrupts = <0x1 0x1d>;
        };
    };
};

