// Fragment that configures a Sony IMX519

cam_node: imx519@1a {
	compatible = "sony,imx519";
	reg = <0x1a>;
	status = "disabled";

	clocks = <&cam1_clk>;
	clock-names = "xclk";

	VANA-supply = <&cam1_reg>;	/* 2.8v */
	VDIG-supply = <&cam_dummy_reg>;	/* 1.8v */
	VDDL-supply = <&cam_dummy_reg>;	/* 1.2v */

	rotation = <0>;
	orientation = <2>;

	port {
		cam_endpoint: endpoint {
			clock-lanes = <0>;
			data-lanes = <1 2>;
			clock-noncontinuous;
			link-frequencies =
				/bits/ 64 <408000000>;
		};
	};
};

vcm_node: ak7375@c {
	compatible = "asahi-kasei,ak7375";
	reg = <0x0c>;
	status = "disabled";
	vdd-supply = <&cam1_reg>;
};
