// ms5805 pressure sensor
/dts-v1/;
/plugin/;

/ {
        compatible = "brcm,bcm2835";

        fragment@0 {
                target = <&i2c_arm>;
                __overlay__ {
                        #address-cells = <1>;
                        #size-cells = <0>;
                        status = "okay";

                        ms5805: ms5805@76 {
                                compatible = "meas,ms5805";
                                reg = <0x76>;
                        };
                };
        };

        __overrides__ {
                addr = <&ms5805>,"reg:0";
        };
};

