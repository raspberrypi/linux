/dts-v1/;
/plugin/;

/ {
	compatible = "brcm,bcm2835";

	fragment@0 {
		target = <&gpio>;
		__overlay__ {
			gpio_ir_tx_pins: gpio_ir_tx_pins@12 {
				brcm,pins = <18>;
				brcm,function = <1>;	// out
			};
		};
	};

	fragment@1 {
		target-path = "/";
		__overlay__ {
			gpio_ir_tx: gpio-ir-transmitter@12 {
				compatible = "gpio-ir-tx";
				pinctrl-names = "default";
				pinctrl-0 = <&gpio_ir_tx_pins>;
				gpios = <&gpio 18 0>;
			};
		};
	};

	__overrides__ {
		gpio_pin = <&gpio_ir_tx>, "gpios:4",           	// pin number
			   <&gpio_ir_tx>, "reg:0",
			   <&gpio_ir_tx_pins>, "brcm,pins:0",
			   <&gpio_ir_tx_pins>, "reg:0";
		invert = <&gpio_ir_tx>, "gpios:8";		// 1 = active low
	};
};
