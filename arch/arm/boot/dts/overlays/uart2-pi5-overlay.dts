/dts-v1/;
/plugin/;

/{
	compatible = "brcm,bcm2712";

	fragment@0 {
		target = <&uart2>;
		frag0: __overlay__ {
			status = "okay";
			pinctrl-0 = <&uart2_pins>;
		};
	};

	__overrides__ {
		ctsrts = <&frag0>,"pinctrl-0:4=",<&uart2_ctsrts_pins>;
	};
};
