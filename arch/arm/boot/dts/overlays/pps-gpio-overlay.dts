/dts-v1/;
/plugin/;

/ {
	compatible = "brcm,bcm2708";
	fragment@0 {
		target-path = "/";
		__overlay__ {
			pps: pps@12 {
				compatible = "pps-gpio";
				pinctrl-names = "default";
				pinctrl-0 = <&pps_pins>;
				gpios = <&gpio 18 0>;
				status = "okay";
			};
		};
	};

	fragment@1 {
		target = <&gpio>;
		__overlay__ {
			pps_pins: pps_pins@12 {
				brcm,pins =     <18>;
				brcm,function = <0>;    // in
				brcm,pull =     <0>;    // off
			};
		};
	};

	__overrides__ {
		gpiopin = <&pps>,"gpios:4",
			  <&pps>,"reg:0",
			  <&pps_pins>,"brcm,pins:0",
			  <&pps_pins>,"reg:0";
		assert_falling_edge = <&pps>,"assert-falling-edge?";
		capture_clear = <&pps>,"capture-clear?";
	};
};
