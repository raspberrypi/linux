/*
 * Universal device tree overlay for SPI devices
 */

/dts-v1/;
/plugin/;

/ {
	compatible = "brcm,bcm2835";

	fragment@0 {
		target = <&spidev0>;
		__dormant__ {
			status = "disabled";
		};
	};

	fragment@1 {
		target = <&spidev1>;
		__dormant__ {
			status = "disabled";
		};
	};

	fragment@2 {
		target-path = "spi1/spidev@0";
		__dormant__ {
			status = "disabled";
		};
	};

	fragment@3 {
		target-path = "spi1/spidev@1";
		__dormant__ {
			status = "disabled";
		};
	};

	fragment@4 {
		target-path = "spi1/spidev@2";
		__dormant__ {
			status = "disabled";
		};
	};

	fragment@5 {
		target-path = "spi2/spidev@0";
		__dormant__ {
			status = "disabled";
		};
	};

	fragment@6 {
		target-path = "spi2/spidev@1";
		__dormant__ {
			status = "disabled";
		};
	};

	fragment@7 {
		target-path = "spi2/spidev@2";
		__dormant__ {
			status = "disabled";
		};
	};

	fragment@8 {
		target = <&spi0>;
		__dormant__ {
			status = "okay";
			#address-cells = <1>;
			#size-cells = <0>;

			anyspi_00: anyspi@0 {
				reg = <0>;
				spi-max-frequency = <500000>;
			};
		};
	};

	fragment@9 {
		target = <&spi0>;
		__dormant__ {
			status = "okay";
			#address-cells = <1>;
			#size-cells = <0>;

			anyspi_01: anyspi@1 {
				reg = <1>;
				spi-max-frequency = <500000>;
			};
		};
	};

	fragment@10 {
		target = <&spi1>;
		__dormant__ {
			status = "okay";
			#address-cells = <1>;
			#size-cells = <0>;

			anyspi_10: anyspi@0 {
				reg = <0>;
				spi-max-frequency = <500000>;
			};
		};
	};

	fragment@11 {
		target = <&spi1>;
		__dormant__ {
			status = "okay";
			#address-cells = <1>;
			#size-cells = <0>;

			anyspi_11: anyspi@1 {
				reg = <1>;
				spi-max-frequency = <500000>;
			};
		};
	};

	fragment@12 {
		target = <&spi1>;
		__dormant__ {
			status = "okay";
			#address-cells = <1>;
			#size-cells = <0>;

			anyspi_12: anyspi@2 {
				reg = <2>;
				spi-max-frequency = <500000>;
			};
		};
	};

	fragment@13 {
		target = <&spi2>;
		__dormant__ {
			status = "okay";
			#address-cells = <1>;
			#size-cells = <0>;

			anyspi_20: anyspi@0 {
				reg = <0>;
				spi-max-frequency = <500000>;
			};
		};
	};

	fragment@14 {
		target = <&spi2>;
		__dormant__ {
			status = "okay";
			#address-cells = <1>;
			#size-cells = <0>;

			anyspi_21: anyspi@1 {
				reg = <1>;
				spi-max-frequency = <500000>;
			};
		};
	};

	fragment@15 {
		target = <&spi2>;
		__dormant__ {
			status = "okay";
			#address-cells = <1>;
			#size-cells = <0>;

			anyspi_22: anyspi@2 {
				reg = <2>;
				spi-max-frequency = <500000>;
			};
		};
	};

	__overrides__ {
		spi0-0 = <0>, "+0+8";
		spi0-1 = <0>, "+1+9";
		spi1-0 = <0>, "+2+10";
		spi1-1 = <0>, "+3+11";
		spi1-2 = <0>, "+4+12";
		spi2-0 = <0>, "+5+13";
		spi2-1 = <0>, "+6+14";
		spi2-2 = <0>, "+7+15";
		dev = <&anyspi_00>,"compatible",
		      <&anyspi_01>,"compatible",
		      <&anyspi_10>,"compatible",
		      <&anyspi_11>,"compatible",
		      <&anyspi_12>,"compatible",
		      <&anyspi_20>,"compatible",
		      <&anyspi_21>,"compatible",
		      <&anyspi_22>,"compatible";
		speed = <&anyspi_00>, "spi-max-frequency:0",
		        <&anyspi_01>, "spi-max-frequency:0",
		        <&anyspi_10>, "spi-max-frequency:0",
		        <&anyspi_11>, "spi-max-frequency:0",
		        <&anyspi_12>, "spi-max-frequency:0",
		        <&anyspi_20>, "spi-max-frequency:0",
		        <&anyspi_21>, "spi-max-frequency:0",
		        <&anyspi_22>, "spi-max-frequency:0";
	};
};
