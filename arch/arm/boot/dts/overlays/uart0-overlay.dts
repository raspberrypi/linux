/dts-v1/;
/plugin/;

/{
	compatible = "brcm,bcm2835";

	fragment@0 {
		target = <&uart0>;
		__overlay__ {
			pinctrl-names = "default";
			pinctrl-0 = <&uart0_pins>;
			status = "okay";
		};
	};

	fragment@1 {
		target = <&gpio>;
		__overlay__ {
			uart0_pins: uart0_pins {
				brcm,pins = <14 15>;
				brcm,function = <4>; /* alt0 */
				brcm,pull = <0 2>;
			};
		};
	};

	__overrides__ {
		txd0_pin = <&uart0_pins>,"brcm,pins:0";
		rxd0_pin = <&uart0_pins>,"brcm,pins:4";
		pin_func = <&uart0_pins>,"brcm,function:0";
	};
};
