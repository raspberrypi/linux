// SPDX-License-Identifier: GPL-2.0-only
// Definitions for IMX290 camera module on VC I2C bus
/dts-v1/;
/plugin/;

#include <dt-bindings/gpio/gpio.h>
#include "imx290_327-overlay.dtsi"

/{
	compatible = "brcm,bcm2835";

	// Fragment numbers deliberately high to avoid conflicts with the
	// included imx290_327 overlay file.

	fragment@101 {
		target = <&imx290>;
		__overlay__ {
			compatible = "sony,imx290";
		};
	};

	fragment@102 {
		target = <&imx290>;
		__dormant__ {
			compatible = "sony,imx290-mono";
		};
	};

	__overrides__ {
		mono = <0>, "-101+102";
	};
};
