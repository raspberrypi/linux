/dts-v1/;
/plugin/;

/ {
	compatible = "brcm,bcm2835";

	fragment@0 {
		target = <&i2c_arm>;
		__overlay__ {
			#address-cells = <1>;
			#size-cells = <0>;
			status = "okay";
			clock-frequency = <400000>;

			mlx90640: mlx90640@33 {
				compatible = "melexis,mlx90640";
				reg = <0x33>;
				status = "okay";
			};
		};
	};
};
