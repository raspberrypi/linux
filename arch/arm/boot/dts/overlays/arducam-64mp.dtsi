// Fragment that configures a Arducam64MP

cam_node: arducam_64mp@1a {
	compatible = "arducam,64mp";
	reg = <0x1a>;
	status = "disabled";

	clocks = <&cam1_clk>;
	clock-names = "xclk";

	VANA-supply = <&cam1_reg>;	/* 2.8v */
	VDIG-supply = <&cam_dummy_reg>;	/* 1.8v */
	VDDL-supply = <&cam_dummy_reg>;	/* 1.2v */

	rotation = <0>;
	orientation = <2>;

	port {
		cam_endpoint: endpoint {
			clock-lanes = <0>;
			data-lanes = <1 2>;
			clock-noncontinuous;
			link-frequencies =
				/bits/ 64 <456000000>;
		};
	};
};

vcm_node: dw9817_arducam64mp@c {
	compatible = "dongwoon,dw9817-vcm";
	reg = <0x0c>;
	status = "disabled";
	VDD-supply = <&cam1_reg>;
};
