/dts-v1/;
/plugin/;

/{
	compatible = "brcm,bcm2712";

	fragment@0 {
		target = <&i2c0>;
		frag0: __overlay__ {
			status = "okay";
			clock-frequency = <100000>;
		};
	};

	fragment@1 {
		target = <&frag0>;
		__overlay__ {
			pinctrl-0 = <&rp1_i2c0_0_1>;
		};
	};

	fragment@2 {
		target = <&frag0>;
		__dormant__ {
			pinctrl-0 = <&rp1_i2c0_8_9>;
		};
	};

	__overrides__ {
		pins_0_1 = <0>,"+1-2";
		pins_8_9 = <0>,"-1+2";
		baudrate = <&frag0>, "clock-frequency:0";
	};
};
