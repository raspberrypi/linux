// Definitions for I2C based sensors using the Industrial IO or HWMON interface.
#include <dt-bindings/gpio/gpio.h>
#include <dt-bindings/interrupt-controller/irq.h>

/ {
	compatible = "brcm,bcm2835";

	fragment@0 {
		target = <&i2cbus>;
		__dormant__ {
			#address-cells = <1>;
			#size-cells = <0>;
			status = "okay";

			bme280: bme280@76 {
				compatible = "bosch,bme280";
				reg = <0x76>;
				status = "okay";
			};
		};
	};

	fragment@1 {
		target = <&i2cbus>;
		__dormant__ {
			#address-cells = <1>;
			#size-cells = <0>;
			status = "okay";

			bmp085: bmp085@77 {
				compatible = "bosch,bmp085";
				reg = <0x77>;
				default-oversampling = <3>;
				status = "okay";
			};
		};
	};

	fragment@2 {
		target = <&i2cbus>;
		__dormant__ {
			#address-cells = <1>;
			#size-cells = <0>;
			status = "okay";

			bmp180: bmp180@77 {
				compatible = "bosch,bmp180";
				reg = <0x77>;
				status = "okay";
			};
		};
	};

	fragment@3 {
		target = <&i2cbus>;
		__dormant__ {
			#address-cells = <1>;
			#size-cells = <0>;
			status = "okay";

			bmp280: bmp280@76 {
				compatible = "bosch,bmp280";
				reg = <0x76>;
				status = "okay";
			};
		};
	};

	fragment@4 {
		target = <&i2cbus>;
		__dormant__ {
			#address-cells = <1>;
			#size-cells = <0>;
			status = "okay";

			htu21: htu21@40 {
				compatible = "meas,htu21";
				reg = <0x40>;
				status = "okay";
			};
		};
	};

	fragment@5 {
		target = <&i2cbus>;
		__dormant__ {
			#address-cells = <1>;
			#size-cells = <0>;
			status = "okay";

			lm75: lm75@4f {
				compatible = "national,lm75";
				reg = <0x4f>;
				status = "okay";
			};
		};
	};

	fragment@6 {
		target = <&i2cbus>;
		__dormant__ {
			#address-cells = <1>;
			#size-cells = <0>;
			status = "okay";

			si7020: si7020@40 {
				compatible = "silabs,si7020";
				reg = <0x40>;
				status = "okay";
			};
		};
	};

	fragment@7 {
		target = <&i2cbus>;
		__dormant__ {
			#address-cells = <1>;
			#size-cells = <0>;
			status = "okay";

			tmp102: tmp102@48 {
				compatible = "ti,tmp102";
				reg = <0x48>;
				status = "okay";
			};
		};
	};

	fragment@8 {
		target = <&i2cbus>;
		__dormant__ {
			#address-cells = <1>;
			#size-cells = <0>;
			status = "okay";

			hdc100x: hdc100x@40 {
				compatible = "ti,hdc1000";
				reg = <0x40>;
				status = "okay";
			};
		};
	};

	fragment@9 {
		target = <&i2cbus>;
		__dormant__ {
			#address-cells = <1>;
			#size-cells = <0>;
			status = "okay";

			tsl4531: tsl4531@29 {
				compatible = "amstaos,tsl4531";
				reg = <0x29>;
				status = "okay";
			};
		};
	};

	fragment@10 {
		target = <&i2cbus>;
		__dormant__ {
			#address-cells = <1>;
			#size-cells = <0>;
			status = "okay";

			veml6070: veml6070@38 {
				compatible = "vishay,veml6070";
				reg = <0x38>;
				status = "okay";
			};
		};
	};

	fragment@11 {
		target = <&i2cbus>;
		__dormant__ {
			#address-cells = <1>;
			#size-cells = <0>;
			status = "okay";

			sht3x: sht3x@44 {
				compatible = "sensirion,sht3x";
				reg = <0x44>;
				status = "okay";
			};
		};
	};

	fragment@12 {
		target = <&i2cbus>;
		__dormant__ {
			#address-cells = <1>;
			#size-cells = <0>;
			status = "okay";

			ds1621: ds1621@48 {
				compatible = "dallas,ds1621";
				reg = <0x48>;
				status = "okay";
			};
		};
	};

	fragment@13 {
		target = <&i2cbus>;
		__dormant__ {
			#address-cells = <1>;
			#size-cells = <0>;
			status = "okay";

			max17040: max17040@36 {
				compatible = "maxim,max17040";
				reg = <0x36>;
				status = "okay";
			};
		};
	};

	fragment@14 {
		target = <&i2cbus>;
		__dormant__ {
			#address-cells = <1>;
			#size-cells = <0>;
			status = "okay";

			bme680: bme680@76 {
				compatible = "bosch,bme680";
				reg = <0x76>;
				status = "okay";
			};
		};
	};

	fragment@15 {
		target = <&i2cbus>;
		__dormant__ {
			#address-cells = <1>;
			#size-cells = <0>;
			status = "okay";

			sps30: sps30@69 {
				compatible = "sensirion,sps30";
				reg = <0x69>;
				status = "okay";
			};
		};
	};

	fragment@16 {
		target = <&i2cbus>;
		__dormant__ {
			#address-cells = <1>;
			#size-cells = <0>;
			status = "okay";

			sgp30: sgp30@58 {
				compatible = "sensirion,sgp30";
				reg = <0x58>;
				status = "okay";
			};
		};
	};

	fragment@17 {
		target = <&i2cbus>;
		__dormant__ {
			#address-cells = <1>;
			#size-cells = <0>;
			status = "okay";

			ccs811: ccs811@5b {
				compatible = "ams,ccs811";
				reg = <0x5b>;
				status = "okay";
			};
		};
	};

	fragment@18 {
		target = <&i2cbus>;
		__dormant__ {
			#address-cells = <1>;
			#size-cells = <0>;
			status = "okay";

			bh1750: bh1750@23 {
				compatible = "rohm,bh1750";
				reg = <0x23>;
				status = "okay";
			};
		};
	};

	fragment@19 {
		target = <&i2cbus>;
		__dormant__ {
			#address-cells = <1>;
			#size-cells = <0>;
			status = "okay";

			max30102: max30102@57 {
				compatible = "maxim,max30102";
				reg = <0x57>;
				maxim,red-led-current-microamp = <7000>;
				maxim,ir-led-current-microamp  = <7000>;
				interrupt-parent = <&gpio>;
				interrupts = <4 IRQ_TYPE_EDGE_FALLING>;
				pinctrl-0 = <&int_pins>;
				pinctrl-names = "default";
			};
		};
	};

	fragment@20 {
		target = <&i2cbus>;
		__dormant__ {
			#address-cells = <1>;
			#size-cells = <0>;
			status = "okay";

			aht10: aht10@38 {
				compatible = "aosong,aht10";
				reg = <0x38>;
			};
		};
	};

	fragment@21 {
		target = <&i2cbus>;
		__dormant__ {
			#address-cells = <1>;
			#size-cells = <0>;
			status = "okay";

			mcp980x: mcp980x@18 {
				compatible = "maxim,mcp980x";
				reg = <0x18>;
			};
		};
	};

	fragment@22 {
		target = <&i2cbus>;
		__dormant__ {
			#address-cells = <1>;
			#size-cells = <0>;
			status = "okay";

			jc42: jc42@18 {
				compatible = "jedec,jc-42.4-temp";
				reg = <0x18>;
			};
		};
	};

	fragment@23 {
		target = <&i2cbus>;
		__dormant__ {
			#address-cells = <1>;
			#size-cells = <0>;
			status = "okay";

			ms5637: ms5637@76 {
				compatible = "meas,ms5637";
				reg = <0x76>;
			};
		};
	};

	fragment@24 {
		target = <&i2cbus>;
		__dormant__ {
			#address-cells = <1>;
			#size-cells = <0>;
			status = "okay";

			ms5803: ms5803@76 {
				compatible = "meas,ms5803";
				reg = <0x76>;
			};
		};
	};

	fragment@25 {
		target = <&i2cbus>;
		__dormant__ {
			#address-cells = <1>;
			#size-cells = <0>;
			status = "okay";

			ms5805: ms5805@76 {
				compatible = "meas,ms5805";
				reg = <0x76>;
			};
		};
	};

	fragment@26 {
		target = <&i2cbus>;
		__dormant__ {
			#address-cells = <1>;
			#size-cells = <0>;
			status = "okay";

			ms5837: ms5837@76 {
				compatible = "meas,ms5837";
				reg = <0x76>;
			};
		};
	};

	fragment@27 {
		target = <&i2cbus>;
		__dormant__ {
			#address-cells = <1>;
			#size-cells = <0>;
			status = "okay";

			ms8607: ms8607@76 {
				compatible = "meas,ms8607-temppressure";
				reg = <0x76>;
			};
		};
	};

	fragment@28 {
		target = <&i2cbus>;
		__dormant__ {
			#address-cells = <1>;
			#size-cells = <0>;
			status = "okay";
			clock-frequency = <400000>;

			mpu6050: mpu6050@68 {
				compatible = "invensense,mpu6050";
				reg = <0x68>;
				interrupt-parent = <&gpio>;
				interrupts = <4 IRQ_TYPE_EDGE_FALLING>;
				pinctrl-0 = <&int_pins>;
				pinctrl-names = "default";
			};
		};
	};

	fragment@29 {
		target = <&i2cbus>;
		__dormant__ {
			#address-cells = <1>;
			#size-cells = <0>;
			status = "okay";
			clock-frequency = <400000>;

			mpu9250: mpu9250@68 {
				compatible = "invensense,mpu9250";
				reg = <0x68>;
				interrupt-parent = <&gpio>;
				interrupts = <4 IRQ_TYPE_EDGE_FALLING>;
				pinctrl-0 = <&int_pins>;
				pinctrl-names = "default";
			};
		};
	};

	fragment@30 {
		target = <&bno055>;
		__dormant__ {
			reset-gpios = <&gpio 5 GPIO_ACTIVE_LOW>;
		};
	};

	fragment@31 {
		target = <&i2cbus>;
		__dormant__ {
			#address-cells = <1>;
			#size-cells = <0>;
			status = "okay";

			bno055: bno055@29 {
				compatible = "bosch,bno055";
				reg = <0x29>;
			};
		};
	};

	fragment@32 {
		target = <&i2cbus>;
		__dormant__ {
			#address-cells = <1>;
			#size-cells = <0>;
			status = "okay";

			sht4x: sht4x@44 {
				compatible = "sensirion,sht4x";
				reg = <0x44>;
				status = "okay";
			};
		};
	};

	fragment@33 {
		target = <&i2cbus>;
		__dormant__ {
			#address-cells = <1>;
			#size-cells = <0>;
			status = "okay";

			bmp380: bmp380@76 {
				compatible = "bosch,bmp380";
				reg = <0x76>;
				status = "okay";
			};
		};
	};

	fragment@34 {
		target = <&i2cbus>;
		__dormant__ {
			#address-cells = <1>;
			#size-cells = <0>;
			status = "okay";

			adt7410: adt7410@48 {
				compatible = "adi,adt7410", "adi,adt7420";
				reg = <0x48>;
				status = "okay";
			};
		};
	};

	fragment@35 {
		target = <&i2cbus>;
		__dormant__ {
			#address-cells = <1>;
			#size-cells = <0>;
			status = "okay";

			ina238: ina238@48 {
				compatible = "ti,ina238";
				#address-cells = <1>;
				#size-cells = <0>;
				reg = <0x40>;
				/* uOhms, uint32_t */
				shunt-resistor = <1000>;
				/* 1 or 4, (±40.96 mV or ±163.84 mV) */
				ti,shunt-gain = <1>;
			};
		};
	};

	fragment@36 {
		target = <&i2cbus>;
		__dormant__ {
			#address-cells = <1>;
			#size-cells = <0>;
			status = "okay";

			shtc3: shtc3@70 {
				compatible = "sensirion,shtc3";
				reg = <0x70>;
				status = "okay";
			};
		};
	};

	fragment@37 {
		target = <&i2cbus>;
		__dormant__ {
			#address-cells = <1>;
			#size-cells = <0>;
			status = "okay";

			hts221: hts221@5f {
				compatible = "st,hts221-humid", "st,hts221";
				reg = <0x5f>;
				interrupt-parent = <&gpio>;
				interrupts = <4 IRQ_TYPE_EDGE_RISING>;
				pinctrl-0 = <&int_pins>;
				pinctrl-names = "default";
			};
		};
	};

	fragment@38 {
		target = <&i2cbus>;
		__dormant__ {
			#address-cells = <1>;
			#size-cells = <0>;
			status = "okay";

			veml6075: veml6075@10 {
				compatible = "vishay,veml6075";
				reg = <0x10>;
			};
		};
	};

	fragment@39 {
		target = <&i2cbus>;
		__dormant__ {
			#address-cells = <1>;
			#size-cells = <0>;
			status = "okay";

			hdc3020: hdc3020@44 {
				compatible = "ti,hdc3020";
				reg = <0x44>;
				interrupt-parent = <&gpio>;
				interrupts = <4 IRQ_TYPE_EDGE_RISING>;
				pinctrl-0 = <&int_pins>;
				pinctrl-names = "default";
			};
		};
	};

	fragment@40 {
		target = <&i2cbus>;
		__dormant__ {
			#address-cells = <1>;
			#size-cells = <0>;
			status = "okay";

			as73211: as73211@74 {
				compatible = "ams,as73211";
				reg = <0x74>;
				interrupt-parent = <&gpio>;
				interrupts = <4 IRQ_TYPE_EDGE_RISING>;
				pinctrl-0 = <&int_pins>;
				pinctrl-names = "default";
			};
		};
	};

	fragment@41 {
		target = <&i2cbus>;
		__dormant__ {
			#address-cells = <1>;
			#size-cells = <0>;
			status = "okay";

			as7331: as7331@74 {
				compatible = "ams,as7331";
				reg = <0x74>;
				interrupt-parent = <&gpio>;
				interrupts = <4 IRQ_TYPE_EDGE_RISING>;
				pinctrl-0 = <&int_pins>;
				pinctrl-names = "default";
			};
		};
	};

	fragment@99 {
		target = <&gpio>;
		__dormant__ {
			int_pins: int_pins@4 {
					brcm,pins = <4>;
					brcm,function = <0>; /* in */
					brcm,pull = <0>; /* none */
			};
		};
	};

	__overrides__ {
		bme280 = <0>,"+0";
		bmp085 = <0>,"+1";
		bmp180 = <0>,"+2";
		bmp280 = <0>,"+3";
		bmp380 = <0>,"+33";
		htu21 = <0>,"+4";
		lm75 = <0>,"+5";
		lm75addr = <&lm75>,"reg:0";
		si7020 = <0>,"+6";
		tmp102 = <0>,"+7";
		hdc100x = <0>,"+8";
		tsl4531 = <0>,"+9";
		veml6070 = <0>,"+10";
		sht3x = <0>,"+11";
		ds1621 = <0>,"+12";
		max17040 = <0>,"+13";
		bme680 = <0>,"+14";
		sps30 = <0>,"+15";
		sgp30 = <0>,"+16";
		ccs811 = <0>, "+17";
		bh1750 = <0>, "+18";
		max30102 = <0>,"+19+99";
		aht10 = <0>,"+20";
		mcp980x = <0>,"+21";
		jc42 = <0>,"+22";
		ms5637 = <0>,"+23";
		ms5803 = <0>,"+24";
		ms5805 = <0>,"+25";
		ms5837 = <0>,"+26";
		ms8607 = <0>,"+27";
		mpu6050 = <0>,"+28+99";
		mpu9250 = <0>,"+29+99";
		bno055 = <0>,"+31";
		sht4x = <0>,"+32";
		adt7410 = <0>,"+34";
		ina238 = <0>,"+35";
		shtc3 = <0>,"+36";
		hts221 = <0>,"+37+99";
		veml6075 = <0>,"+38";
		hdc3020 = <0>,"+39+99";
		as73211 = <0>,"+40+99";
		as7331 = <0>,"+41+99";

		addr =	<&bme280>,"reg:0", <&bmp280>,"reg:0", <&tmp102>,"reg:0",
			<&lm75>,"reg:0", <&hdc100x>,"reg:0", <&sht3x>,"reg:0",
			<&ds1621>,"reg:0", <&bme680>,"reg:0", <&ccs811>,"reg:0",
			<&bh1750>,"reg:0", <&mcp980x>,"reg:0", <&jc42>,"reg:0",
			<&ms5637>,"reg:0", <&ms5803>,"reg:0", <&ms5805>,"reg:0",
			<&ms5837>,"reg:0", <&ms8607>,"reg:0",
			<&mpu6050>,"reg:0", <&mpu9250>,"reg:0",
			<&bno055>,"reg:0", <&sht4x>,"reg:0",
			<&bmp380>,"reg:0", <&adt7410>,"reg:0", <&ina238>,"reg:0",
			<&hdc3020>,"reg:0", <&as73211>,"reg:0",
			<&as7331>,"reg:0";
		int_pin = <&int_pins>, "brcm,pins:0",
			<&int_pins>, "reg:0",
			<&max30102>, "interrupts:0",
			<&mpu6050>, "interrupts:0",
			<&mpu9250>, "interrupts:0",
			<&hts221>, "interrupts:0",
			<&hdc3020>, "interrupts:0",
			<&as73211>, "interrupts:0",
			<&as7331>, "interrupts:0";
		no_timeout = <&jc42>, "smbus-timeout-disable?";
		reset_pin = <&bno055>,"reset-gpios:4", <0>,"+30";
		shunt_resistor = <&ina238>,"shunt-resistor:0";
		gain = <&ina238>,"ti,shunt-gain:0";
	};
};
