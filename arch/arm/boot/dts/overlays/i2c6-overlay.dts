/dts-v1/;
/plugin/;

/{
	compatible = "brcm,bcm2711";

	fragment@0 {
		target = <&i2c6>;
		frag0: __overlay__ {
			status = "okay";
			pinctrl-names = "default";
			pinctrl-0 = <&i2c6_pins>;
			clock-frequency = <100000>;
		};
	};

	fragment@1 {
		target = <&i2c6_pins>;
		__dormant__ {
			brcm,pins = <0 1>;
		};
	};

	fragment@2 {
		target = <&i2c6_pins>;
		__overlay__ {
			brcm,pins = <22 23>;
		};
	};

	__overrides__ {
		pins_0_1 = <0>,"=1!2";
		pins_22_23 = <0>,"!1=2";
		baudrate = <&frag0>, "clock-frequency:0";
	};
};
