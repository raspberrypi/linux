// Fragment that configures a Sony IMX708

cam_node: imx708@1a {
	compatible = "sony,imx708";
	reg = <0x1a>;
	status = "disabled";

	clocks = <&cam1_clk>;
	clock-names = "inclk";

	vana1-supply = <&cam1_reg>;	/* 2.8v */
	vana2-supply = <&cam_dummy_reg>;/* 1.8v */
	vdig-supply = <&cam_dummy_reg>;	/* 1.1v */
	vddl-supply = <&cam_dummy_reg>;	/* 1.8v */

	rotation = <180>;
	orientation = <2>;

	port {
		cam_endpoint: endpoint {
			clock-lanes = <0>;
			data-lanes = <1 2>;
			clock-noncontinuous;
			link-frequencies =
				/bits/ 64 <450000000>;
		};
	};
};

vcm_node: dw9817@c {
	compatible = "dongwoon,dw9817-vcm";
	reg = <0x0c>;
	status = "disabled";
	VDD-supply = <&cam1_reg>;
};
