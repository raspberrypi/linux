/*
 * TI ADS1115 multi-channel ADC overlay
 */

/dts-v1/;
/plugin/;

/ {
	compatible = "brcm,bcm2835";

	fragment@0 {
		target = <&ads1115>;
		__dormant__ {
			#address-cells = <1>;
			#size-cells = <0>;

			channel_a: channel_a {
				reg = <4>;
				ti,gain = <1>;
				ti,datarate = <7>;
			};
		};
	};

	fragment@1 {
		target = <&ads1115>;
		__dormant__ {
			#address-cells = <1>;
			#size-cells = <0>;

			channel_b: channel_b {
				reg = <5>;
				ti,gain = <1>;
				ti,datarate = <7>;
			};
		};
	};

	fragment@2 {
		target = <&ads1115>;
		__dormant__ {
			#address-cells = <1>;
			#size-cells = <0>;

			channel_c: channel_c {
				reg = <6>;
				ti,gain = <1>;
				ti,datarate = <7>;
			};
		};
	};

	fragment@3 {
		target = <&ads1115>;
		__dormant__ {
			#address-cells = <1>;
			#size-cells = <0>;

			channel_d: channel_d {
				reg = <7>;
				ti,gain = <1>;
				ti,datarate = <7>;
			};
		};
	};

	fragment@4 {
		target = <&i2cbus>;
		__overlay__ {
			#address-cells = <1>;
			#size-cells = <0>;
			status = "okay";

			ads1115: ads1115@48 {
				compatible = "ti,ads1115";
				status = "okay";
				#address-cells = <1>;
				#size-cells = <0>;
				reg = <0x48>;
			};
		};
	};

	frag100: fragment@100 {
		target = <&i2c1>;
		i2cbus: __overlay__ {
			status = "okay";
		};
	};

	fragment@101 {
		target = <&i2c0if>;
		__dormant__ {
			status = "okay";
		};
	};

	fragment@102 {
		target = <&i2c0mux>;
		__dormant__ {
			status = "okay";
		};
	};

	__overrides__ {
		addr =            <&ads1115>,"reg:0";
		cha_enable =      <0>,"=0";
		cha_cfg =         <&channel_a>,"reg:0";
		cha_gain =        <&channel_a>,"ti,gain:0";
		cha_datarate =    <&channel_a>,"ti,datarate:0";
		chb_enable =      <0>,"=1";
		chb_cfg =         <&channel_b>,"reg:0";
		chb_gain =        <&channel_b>,"ti,gain:0";
		chb_datarate =    <&channel_b>,"ti,datarate:0";
		chc_enable =      <0>,"=2";
		chc_cfg =         <&channel_c>,"reg:0";
		chc_gain =        <&channel_c>,"ti,gain:0";
		chc_datarate =    <&channel_c>,"ti,datarate:0";
		chd_enable =      <0>,"=3";
		chd_cfg =         <&channel_d>,"reg:0";
		chd_gain =        <&channel_d>,"ti,gain:0";
		chd_datarate =    <&channel_d>,"ti,datarate:0";
		i2c0 = <&frag100>, "target:0=",<&i2c0>;
		i2c_csi_dsi = <&frag100>, "target:0=",<&i2c_csi_dsi>,
			      <0>,"+101+102";
		i2c3 = <&frag100>, "target?=0",
		       <&frag100>, "target-path=i2c3";
		i2c4 = <&frag100>, "target?=0",
		       <&frag100>, "target-path=i2c4";
		i2c5 = <&frag100>, "target?=0",
		       <&frag100>, "target-path=i2c5";
		i2c6 = <&frag100>, "target?=0",
		       <&frag100>, "target-path=i2c6";
		i2c-path = <&frag100>, "target?=0",
		       <&frag100>, "target-path";
	};
};
