// SPDX-License-Identifier: GPL-2.0-only
// Definitions for VD65G4 camera module on VC I2C bus

/dts-v1/;
/plugin/;

#include <dt-bindings/gpio/gpio.h>
#include "vd55g1_vd65g4-overlay.dtsi"

/{
	compatible = "brcm,bcm2835";

	// Fragment numbers deliberately high to avoid conflicts with the
	// included vd55g1_vd65g4 overlay file.

	fragment@101 {
		target = <&cam_node>;
		__overlay__ {
			compatible = "st,vd65g4";
		};
	};
};
