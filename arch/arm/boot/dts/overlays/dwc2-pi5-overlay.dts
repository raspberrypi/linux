#include "dwc2-overlay.dts"

/{
	fragment@1 {
		target-path = "/";
		__overlay__ {
			/*
			 * Add a node with a dma-ranges value that exists only to be found
			 * by of_dma_get_max_cpu_address, and hence limit the DMA zone.
			 */
			zone_dma {
				 #address-cells = <1>;
				 #size-cells = <1>;
				 dma-ranges = <0x0  0x0 0x0  0x40000000>;
			};
		};
	};
};
