// Overlay for MCP3421-8 ADCs from Microchip Semiconductor

/dts-v1/;
/plugin/;

/ {
	compatible = "brcm,bcm2835";

	fragment@0 {
		target = <&i2c1>;
		__dormant__ {
			#address-cells = <1>;
			#size-cells = <0>;

			status = "okay";

			mcp3421: mcp@68 {
				reg = <0x68>;
				compatible = "microchip,mcp3421";

				status = "okay";
			};
		};
	};

	fragment@1 {
		target = <&i2c1>;
		__dormant__ {
			#address-cells = <1>;
			#size-cells = <0>;

			status = "okay";

			mcp3422: mcp@68 {
				reg = <0x68>;
				compatible = "microchip,mcp3422";

				status = "okay";
			};
		};
	};

	fragment@2 {
		target = <&i2c1>;
		__dormant__ {
			#address-cells = <1>;
			#size-cells = <0>;

			status = "okay";

			mcp3423: mcp@68 {
				reg = <0x68>;
				compatible = "microchip,mcp3423";

				status = "okay";
			};
		};
	};

	fragment@3 {
		target = <&i2c1>;
		__dormant__ {
			#address-cells = <1>;
			#size-cells = <0>;

			status = "okay";

			mcp3424: mcp@68 {
				reg = <0x68>;
				compatible = "microchip,mcp3424";

				status = "okay";
			};
		};
	};

	fragment@4 {
		target = <&i2c1>;
		__dormant__ {
			#address-cells = <1>;
			#size-cells = <0>;

			status = "okay";

			mcp3425: mcp@68 {
				reg = <0x68>;
				compatible = "microchip,mcp3425","mcp3425";

				status = "okay";
			};
		};
	};

	fragment@5 {
		target = <&i2c1>;
		__dormant__ {
			#address-cells = <1>;
			#size-cells = <0>;

			status = "okay";

			mcp3426: mcp@68 {
				reg = <0x68>;
				compatible = "microchip,mcp3426";

				status = "okay";
			};
		};
	};

	fragment@6 {
		target = <&i2c1>;
		__dormant__ {
			#address-cells = <1>;
			#size-cells = <0>;

			status = "okay";

			mcp3427: mcp@68 {
				reg = <0x68>;
				compatible = "microchip,mcp3427";

				status = "okay";
			};
		};
	};

	fragment@7 {
		target = <&i2c1>;
		__dormant__ {
			#address-cells = <1>;
			#size-cells = <0>;

			status = "okay";

			mcp3428: mcp@68 {
				reg = <0x68>;
				compatible = "microchip,mcp3428";

				status = "okay";
			};
		};
	};

	__overrides__ {
		addr = <&mcp3421>,"reg:0",
		       <&mcp3422>,"reg:0",
		       <&mcp3423>,"reg:0",
		       <&mcp3424>,"reg:0",
		       <&mcp3425>,"reg:0",
		       <&mcp3426>,"reg:0",
		       <&mcp3427>,"reg:0",
		       <&mcp3428>,"reg:0";
		mcp3421 = <0>,"=0";
		mcp3422 = <0>,"=1";
		mcp3423 = <0>,"=2";
		mcp3424 = <0>,"=3";
		mcp3425 = <0>,"=4";
		mcp3426 = <0>,"=5";
		mcp3427 = <0>,"=6";
		mcp3428 = <0>,"=7";
	};
};

