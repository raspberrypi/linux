// Definitions for w1-gpio module (without external pullup)
/dts-v1/;
/plugin/;

#include <dt-bindings/gpio/gpio.h>

/ {
	compatible = "brcm,bcm2835";

	fragment@0 {
		target-path = "/";
		__overlay__ {

			w1: onewire@0 {
				compatible = "w1-gpio";
				gpios = <&gpio 4 (GPIO_ACTIVE_HIGH | GPIO_PULL_DISABLE)>;
				status = "okay";
			};
		};
	};

	__overrides__ {
		gpiopin =       <&w1>,"gpios:4",
				<&w1>,"reg:0";
		pullup;		// Silently ignore unneeded parameter
	};
};
