// rpi-tv HAT

/dts-v1/;
/plugin/;

/ {
	compatible = "brcm,bcm2708", "brcm,bcm2709";

	fragment@0 {
		target = <&spidev0>;
		__overlay__ {
			status = "disabled";
		};
	};

	fragment@1 {
		target = <&spi0>;
		__overlay__ {
			/* needed to avoid dtc warning */
			#address-cells = <1>;
			#size-cells = <0>;

			status = "okay";

			cxd2880@0 {
				compatible = "sony,cxd2880";
				reg = <0>; /* CE0 */
				spi-max-frequency = <50000000>;
				status = "okay";
			};
		};
	};

};
