#define i2c0 i2c0if
#include "bcm2835.dtsi"
#undef i2c0
#include "bcm270x.dtsi"

/ {
	__overrides__ {
		arm_freq;
	};
};

&soc {
	dma-ranges = <0x80000000 0x00000000 0x20000000>;
};

&vc4 {
	status = "disabled";
};
