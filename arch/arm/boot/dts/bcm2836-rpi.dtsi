// SPDX-License-Identifier: GPL-2.0
#include "bcm2835-rpi.dtsi"

&vchiq {
	compatible = "brcm,bcm2836-vchiq", "brcm,bcm2835-vchiq";
};

&firmware {
	firmware_clocks: clocks {
		compatible = "raspberrypi,firmware-clocks";
		#clock-cells = <1>;
	};
};
